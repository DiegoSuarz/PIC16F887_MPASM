;DESCRIPCION:
;USANDO EL TIMER 0 COMO FUENTE DE INTERRUPCION,
;DEBE CONTAR EVENTOS POR LA TERMINAL RA4,
;AL LLEGAR A 2500 DEBE EMITIR UN TONO DE 1KHZ(RC2) DURANTE 500ms
;EN EL PROGRAMA PRINCIPAL ESTARа DE FORMA PERMANENTE EL CONTADOR DE 
;00 A 99 POR LOS DISPLAYS DE 7 SEGMENTOS, PERO ESTA SECUENCIA TAMBIиN
;PUEDE SER INTERRUPIDA POR RB0/INT, AL ENTRAR A LA INTERRUPCION 
;GENERARа EL NUMERO ALEATORIO Y LO IMPRIMIRа EN LA LCD
;---------------------------MACROS-----------------------------------
SIETE_SG_KC	MACRO
SIETE_SEG:						
			ADDWF		PCL,F

			DT			0X3F,0X06,0X5B,0X4F,0X66,0X7D,0X07,0X7F,0X6F,0X77,0X7C,0X39,0X5E,0X79,0X71
			ENDM

;---------------------------DEFINE-----------------------------------
;DEFINICIONES PARA DISPLAY 7 SEGMENTOS
			#DEFINE	UNIDAD_ENA	BSF	PORTA,0
			#DEFINE	UNIDAD_DIS	BCF	PORTA,0
			#DEFINE DECENA_ENA	BSF	PORTA,1
			#DEFINE DECENA_DIS	BCF	PORTA,1
			
;----------------------------EQU--------------------------------------
UNIDAD		EQU	0X20
DECENA		EQU 0X21	
CONT60		EQU	0X22

CONT5		EQU 0X23
ALEATORIO	EQU	0X24
;--------------------------CBLOCK-------------------------------------
					CBLOCK		0X25
								UNIDADES,DECENAS,CENTENAS
					ENDC
;---------------------------HEADER------------------------------------

					INCLUDE		<D:\Archivos\Programacion\Microcontroladores\PIC\ASSEMBLER\MPASM\PIC16F887\LIBRERIAS\MACROS_INTERRUPT.ASM>
					INCLUDE		<D:\Archivos\Programacion\Microcontroladores\PIC\ASSEMBLER\MPASM\PIC16F887\LIBRERIAS\MACROS_LCD.ASM>		
					;INCLUDE		<D:\Archivos\Programacion\Microcontroladores\PIC\ASSEMBLER\MPASM\PIC16F887\LIBRERIAS\MACROS_7SEG.ASM>	;MACRO PARA EL USO DISPLAY 7 SEG					
					INCLUDE		<D:\Archivos\Programacion\Microcontroladores\PIC\ASSEMBLER\MPASM\PIC16F887\LIBRERIAS\RETARDOS_MACROS.ASM> ;MACRO DE RETARDO
					INCLUDE		<D:\Archivos\Programacion\Microcontroladores\PIC\ASSEMBLER\MPASM\PIC16F887\LIBRERIAS\MACROS_CONFIGURACION_INT.ASM> ;MACRO DE CONFIGURACION BASICA
	
					ORG			0X0000			;EMPEZAR EN LA DIRECCION 0 DE LA MEMORIA DE PROGRAMA
					GOTO		INICIALIZA
					ORG			0X0004			;VECTOR DE INTERRUPCION
					SAVE_REG					;GUARDAR REGISTROS DE INTERES
					GOTO		ISR
					;VECTOR_INTERRUPCION			;SI SE USA INTERRUPCIONES DESCOMENTAR
					SIETE_SG_KC					;SI SE USA DISPLAY 7 SEG DESCOMENTAR
					CONFIGURACION				;NOS DEJA EN EL BANCO 1
					
;-----------------------CODIGO PRINCIPAL------------------------------
;ETIQUETAS			|NEMONICOS		| OPERANDOS 		| COMENTARIOS	
					CLRF			TRISB
					CLRF			TRISD
					BCF				TRISA,0				;RA0 COMO SALIDA
					BCF				TRISA,1				;RA1 COMO SALIDA
					BCF				TRISC,2
;************CONFIGURACION TMR0 *****************************************************
					
			
;************CONFIGURACION INTERRUPCION EXTERNA***************************************
					BCF				OPTION_REG,INTEDG	;DETECCION DE FLANCO DE BAJADA
					BCF				INTCON,INTF			;LIMPIAR BANDERA DE INTERRUPCION
					BSF				INTCON,INTE			;HABILITAR INTERRUPCION EXTERNA
					BSF				INTCON,GIE			;HABILITAR INTERRUPCIONES GLOBALES
					
					
					BCF				STATUS,RP0			;BANCO 0
			
				
					CALL			INIT_LCD			;INICIALIZAR PANTALLA LCD
					FILA1_COLUMNA	.0					;POSICIONAR CURSOR EN LA FILA 1 COLUMNA 0
					MENSAJE_FILA1						;MOSTRAR EL MENSAJE EN LA FILA 1
					FILA2_COLUMNA	.0					;POSICIONAR CURSOR EN LA FILA 2 COLUMNA 0
					MENSAJE_FILA2						;MOSTRAR EL MENSAJE EN LA FILA 2

					BSF				STATUS,RP0			;BANCO 1
					COMF			TRISB,F				;PUERTO B COMO ENTRADA
					BCF				STATUS,RP0			;BANCO 0

;-------------------------------------------------LOOP--------------------------------------					

LIMPIA_DEC: 		CLRF		DECENA			;LIMPIAMOS LA VARIABLE DECENA (0X21)			
LIMPIA_UNI:			CLRF		UNIDAD			;LIMPIAMOS LA VARIABLE UNIDAD (0X20)

			
RECARGA60:			MOVLW		.60
					MOVWF		CONT60			;CARGARMOS LA VARIABLE CONT60 CON .60

VISUALIZAR:			MOVF		UNIDAD,W		;LEEMOS LA VARIABLE UNIDAD Y LO ALMACENAMOS EN W
					CALL		SIETE_SEG		;LLAMAMOS A LA RUTINA 7 SEG
					MOVWF		PORTD			;VISUALIZAMOS LA UNIDAD POR EL PUERTO D

					UNIDAD_ENA					;ENCENDER UNIDADES DISPLAY(ENCENDER TRANSITOR RA0)
					CALL		RETARDO_8mS
					UNIDAD_DIS					;ENCENDER UNIDADES DISPLAY(APAGAR TRANSITOR RA0)

					MOVF		DECENA,W		;LEEMOS LA VARIABLE UNIDAD Y LO ALMACENAMOS EN W
					CALL		SIETE_SEG		;LLAMAMOS A LA RUTINA 7 SEG
					MOVWF		PORTD			;VISUALIZAMOS LA DECENA POR EL PUERTO D

					DECENA_ENA					;ENCENDER DECENAS DISPLAY(ENCENDER TRANSITOR RA1)
					CALL		RETARDO_8mS
					DECENA_DIS					;APAGAR DECENAS DISPLAY(APAGAR TRANSITOR RA1)
			
					DECFSZ		CONT60,F		;BUCLE PARA REPETIR 60 VECES LA VISUALIZACION DE LOS DIGITOS
					GOTO		VISUALIZAR			
		
					INCF		UNIDAD,F		;INCREMENTAR LA VARIABLE UNIDAD
					MOVLW		0X09			
					XORWF		UNIDAD,W		
					BTFSS		STATUS,Z		;UNIDAD == 9?
					GOTO		RECARGA60		;NO, VE A REPETIR HASTA QUE SE CUMPLAN LOS 60 SIGLOS
					INCF		DECENA,F		;SI, INCREMENTA DECENA EN UNA UNIDAD, Y LIMPIA UNIDADES
					MOVLW		0X09
					XORWF		DECENA,W
					BTFSS		STATUS,Z		;DECENA == 9?
					GOTO		LIMPIA_UNI		;NO, VE A LIMPIAR UNIDADES, PERO MANTENER LAS DECENAS 
					GOTO		LIMPIA_DEC		;SI, VE Y LIMPIA UNIDADES Y DECENAS		
				
				
;------------------SERVICIO DE RUTINA DE INTERRUPCION-------------------------

ISR:				;CLRF			PORTA
					CALL			SUBT25MS
					INCF			ALEATORIO,F
					BTFSS			PORTB,0
					GOTO			$-2
					CALL			SUBT25MS

					CLRF			UNIDADES
					CLRF			DECENAS
					CLRF			CENTENAS

;******************EXTRAER CENTENAS*********************************
RESTA100:			MOVLW			.100
					SUBWF			ALEATORIO,F
					BTFSS			STATUS,C
					GOTO			SUMA100
					INCF			CENTENAS,F
					GOTO			RESTA100
SUMA100:			MOVLW			.100
					ADDWF			ALEATORIO,F

;******************EXTRAER DECENAS*********************************
RESTA10:			MOVLW			.10
					SUBWF			ALEATORIO,F
					BTFSS			STATUS,C
					GOTO			SUMA10
					INCF			DECENAS,F
					GOTO			RESTA10
SUMA10:				MOVLW			.10
					ADDWF			ALEATORIO,F

;******************EXTRAER UNIDADES*********************************
					MOVF			ALEATORIO,W
					MOVWF			UNIDADES

					BSF				STATUS,RP0
					COMF			TRISB,F				;PUERTO B COMO ENTRADA PARA ENVIAR COMANDOS LCD
					BCF				STATUS,RP0
			
;***************DE BCD A DECIMAL USANDO CAR ASCII*****************		
					MOVLW			0X30				;EN CODIGO ASCII LOS NUMERO EMPIEZAN DESDE LA POSICION 0X30
					ADDWF			UNIDADES,F
					ADDWF			DECENAS,F
					ADDWF			CENTENAS,F
				
					FILA2_COLUMNA	.13					;UBICAMOS EL CURSOR EN LA FILA 2 COLUMNA 14
					MOVF			CENTENAS,W
					CALL			ESCRIBE_CARACTER	;ESCRIBE CARACTER DE CENTENAS EN LA POSICION 14
					MOVF			DECENAS,W						
					CALL			ESCRIBE_CARACTER	;ESCRIBE CARACTER DE DECENAS EN LA POSICION 15
					MOVF			UNIDADES,W
					CALL			ESCRIBE_CARACTER	;ESCRIBE CARACTER DE UNIDADES EN LA POSICION 16

				
					BSF				STATUS,RP0			;BANCO 1
					COMF			TRISB,F				;PUERTO B COMO ENTRADA
					BCF				STATUS,RP0			;BANCO 0
					
					BCF				INTCON,INTF			;LIMPIAMOS LA BANDERA DE INTERRUPCION
					
FIN_INT:			RESTORE_REG							;RESTAURAMOS LOS REGISTROS DE INTERES
					RETFIE			
					
;-------------------------SUBRUTINAS----------------------------------
SUBT25MS:			RETARDO_3V		.3,.47,.25
					RETURN
RETARDO_8mS:		RETARDO_2V		.6,.181			;RETARDO DE 8mS PARA LA PERSISTENCIA DE LA VISION
					RETURN
T500US:				RETARDO_3V  	.1,.69,.1
					RETURN

;---------------------------TABLAS------------------------------------

;----------------------------TABLAS_LCD-------------------------------
;************************************                *****************
					MENSAJE_F1		"EL NUMERO       "		
					MENSAJE_F2		"ALEATORIO ES:   "	

;---------------------------LIBRERIAS--------------------------------
					INCLUDE		<D:\Archivos\Programacion\Microcontroladores\PIC\ASSEMBLER\MPASM\PIC16F887\LIBRERIAS\LIBRERIA_RETARDOS.asm>
					INCLUDE		<D:\Archivos\Programacion\Microcontroladores\PIC\ASSEMBLER\MPASM\PIC16F887\LIBRERIAS\LIBRERIA_LCD.asm>		
					END

;COMENTARIOS
;PARA INICIALIZAR PANTALLA LCD: LLAMAR SUBRUTINA   INIT_LCD
;PARA ESCOJER UNA COLUMNA DE LA FILA1:  	FILA1_COLUMNA	.X		X: 0-15
;MOSTRAR MENSAJE EN LA FILA 1 CON LA MACRO  	MENSAJE_FILA1	
;PARA ESCOJER UNA COLUMNA DE LA FILA2:  	FILA2_COLUMNA	.X		X: 0-15
;MOSTRAR MENSAJE EN LA FILA 2 CON LA MACRO  	MENSAJE_FILA2	