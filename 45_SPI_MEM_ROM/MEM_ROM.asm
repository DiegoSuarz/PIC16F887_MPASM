;DESCRIPCION:
;EJEMPLO DE COMUNICACIÓN SPI CON LA MEMORIA 25AA080B
;EL RELOJ SERA FOSC/4, MODO DEL RELOJ 1,1 ==> CKP=1 Y CKE=0
;EL ESCALVO SE SELECCIONA CON EL PORTC,0
;EJEMPLO DE ESCRITURA Y LECTURA DE 32 BYTES
;---------------------------MACROS----------------------------
;---------------------------DEFINE----------------------------
;----------------------------EQU------------------------------
NUM_REGISTROS		EQU		.32		;LA CANTIDAD MAXIMA DE REGISTROS QUE SE PUEDEN ESCRIBIR EN LA MEMORIA
;---------------------------CBLOCK----------------------------
;---------------------------HEADER----------------------------
;					INCLUDE		<D:\Archivos\Programacion\Microcontroladores\PIC\ASSEMBLER\MPASM\PIC16F887\LIBRERIAS\MACROS_INTERRUPT.ASM>	;MACRO PARA EL USO DE INTERRUPCIONES
;					INCLUDE		<D:\Archivos\Programacion\Microcontroladores\PIC\ASSEMBLER\MPASM\PIC16F887\LIBRERIAS\MACROS_LCD.ASM>	;MACRO PARA EL USO DISPLAY LCD
;					INCLUDE		<D:\Archivos\Programacion\Microcontroladores\PIC\ASSEMBLER\MPASM\PIC16F887\LIBRERIAS\MACROS_7SEG.ASM>	;MACRO PARA EL USO DISPLAY 7 SEG					
					INCLUDE		<D:\Archivos\Programacion\Microcontroladores\PIC\ASSEMBLER\MPASM\PIC16F887\LIBRERIAS\RETARDOS_MACROS.ASM> ;MACRO DE RETARDO
					INCLUDE		<D:\Archivos\Programacion\Microcontroladores\PIC\ASSEMBLER\MPASM\PIC16F887\LIBRERIAS\MACROS_CONFIGURACION_INT.ASM> ;MACRO DE CONFIGURACION BASICA
					ORG			0X0000			;EMPEZAR EN LA DIRECCION 0 DE LA MEMORIA DE PROGRAMA
					GOTO		INICIALIZA
;					VECTOR_INTERRUPCION			;SI SE USA INTERRUPCIONES DESCOMENTAR

					CONFIGURACION				;NOS DEJA EN EL BANCO 1						
;-----------------------CODIGO PRINCIPAL------------------------------
;ETIQUETAS			|NEMONICOS		| OPERANDOS 		| COMENTARIOS	
					CLRF			TRISD
					;MOVLW			B'11010110'			;BC5 -> SDO, BC4-> SDI, BC3-> SCK, BC0-> CONTROL DEL SLAVE
	 				;MOVWF			TRISC
					BCF				TRISC,5				;SALIDA SDO (SERIAL DATA OUTPUT)
					BSF				TRISC,4				;ENTRADA SDI (SERIAL DATA INPUT)
					BCF				TRISC,3				;SALIDA SEÑAL DE RELOJ SCK (SERIAL CLOCK)
					
					BCF				TRISC,0				;CONTROL DEL ESCLAVO (SS)
	
										
;*******************CONFIGURACION SPI**************************
					CLRF			SSPSTAT
					BCF				SSPSTAT,SMP			;MUESTREAR ENTRADA DE DATOS EN LA MITAD
					BCF				SSPSTAT,CKE			;CKE=0,CKP = 1,TRANSMISION DE DATA EN EL FLANCO DE SUBIDA OF SCK
					BCF				SSPSTAT,BF			;BANDERA QUE INDICA QUE LA TRANSMISION ESTA COMPLETA (0), 1->TRANSMISION EN PROGRESO
				
					BCF				STATUS,RP0			;BANCO 0
					
					CLRF			SSPCON
					BSF				SSPCON,SSPEN		;HABILITAR PUERTO SERIAL SINCRONO MODO SPI		
					BSF				SSPCON,CKP			;CKP = 1, CKE=0 ,TRANSMISION DE DATA EN EL FLANCO DE SUBIDA OF SCK
		
					BCF				SSPCON,SSPM0		;PUERTO SERIAL SINCRONO COMO SPI MAESTRO FOSC/4 (VELOCIDAD DEL SCK)				
					BCF				SSPCON,SSPM1
					BCF				SSPCON,SSPM2
					BCF				SSPCON,SSPM3
;******************************************************************************************************
					BSF				PORTC,0				;ESCLAVO INACTIVO
					
;CARGA CON 0X00 AL REGISTRO DE STATUS DE LA MEMORIA (PARA QUE NO EXISTA MEMORIA BLOQUEADA A LA ESCRITURA)
					BCF				PORTC,0				;ESCLAVO ACTIVO (MEMORIA ACTIVA)
					MOVLW			B'00000001'			;REGISTRO PARA LA ESCRITURA DEL RESGISTRO STATUS DE LA MEMORIA
					CALL			ENVIAR_DATO_SPI		;ENVIAR DATOS A LA MEMORIA 	B'00000001'	
					MOVLW			B'00000000'			;LIMPIAMOS EL REGISTRO W = ; B'0000000'
					CALL			ENVIAR_DATO_SPI		;ENVIAR DATOS A LA MEMORIA 	B'00000000'
					BSF				PORTC,0				;ESCLAVO INACTIVO (MEMORIA DESACTIVADA)
					CALL			RETARDO_5MS			;RETARDO DE 5MS, QUE SE NECESITA PARA LA ESCRITURA DE LA MEMORIA
	
;PERMISO DE ESCRITURA:									
					BCF				PORTC,0				;ESCLAVO ACTIVO (MEMORIA ACTIVA)
					MOVLW			B'00000110'			;REGISTRO PARA LA ESCRITURA DEL RESGISTRO STATUS DE LA MEMORIA
					CALL			ENVIAR_DATO_SPI		;ENVIAR DATOS A LA MEMORIA 	B'00000110'	
					BSF				PORTC,0				;ESCLAVO INACTIVO (MEMORIA DESACTIVADA)
				
;ESCRIBIMOS 32 BYTES:				
					MOVLW			.5					;CONTADOR PARA ESCRIBIR 32 BYTES EN LA MEMORIA, EL CONTADOR EMPIEZA EN 5
					MOVWF			0X20
					MOVLW			NUM_REGISTROS
					MOVWF			0X21


					BCF				PORTC,0				;ESCLAVO ACTIVO (MEMORIA ACTIVA)
					MOVLW			B'00000010'			;ORDEN PARA LA ESCRITURA DE DATOS DE LA MEMORIA
					CALL			ENVIAR_DATO_SPI		;ENVIAR DATOS A LA MEMORIA 	B'00000010'	
					
					;ENVIAR 16 BITS DE LA DIRECCION DONDE SE QUIERE ESCRIBIR, EN ESTE CASO LA DIRECCION 0X0000 (16BITS)
					CLRW								;LIMPIAMOS EL REGISTRO W = ; B'0000000'
					CALL			ENVIAR_DATO_SPI		;ENVIAR DATOS A LA MEMORIA 	B'00000000
					CLRW								;LIMPIAMOS EL REGISTRO W = ; B'0000000'
					CALL			ENVIAR_DATO_SPI		;ENVIAR DATOS A LA MEMORIA 	B'00000000'

ESCRIBIR_32_BYTES	MOVF			0X20,W				;LEER EL VALOR DEL REGISTR0 0X20 -> W
					CALL			ENVIAR_DATO_SPI		;ENVIAR DATOS DEL REGISTRO 0X20 HACIA LA MEMORIA
					
					INCF			0X20,F				;INCREMENTAR EL CONTADOR EN UNA UNIDAD
					DECFSZ			0X21,F				;SI EL NUMERO DE REGISTRO HA ENVIADO LOS 32 BYTES A LA MEMORIA?
					GOTO			ESCRIBIR_32_BYTES	;ESCRIBIENDO LOS 32 BYTES A LA MEMORIA
				
					BSF				PORTC,0				;ESCLAVO INACTIVO (MEMORIA DESACTIVADA)
					CALL			RETARDO_5MS			;RETARDO DE 5MS, QUE SE NECESITA PARA LA ESCRITURA DE LA MEMORIA

;LECTURA DE LOS 32 BYTES DE LA MEMORIA 
					
LOOP:				MOVLW			NUM_REGISTROS
					MOVWF			0X21				;REGISTRO CONTADOR


					BCF				PORTC,0				;ESCLAVO ACTIVO (MEMORIA ACTIVA)
					MOVLW			B'00000011'			;ORDEN PARA LA LECTURA DE DATOS DE LA MEMORIA
					CALL			ENVIAR_DATO_SPI		;ENVIAR DATOS A LA MEMORIA 	B'00000011'	
					
					;ENVIAR 16 BITS DE LA DIRECCION DONDE SE QUIERE LEER, EN ESTE CASO LA DIRECCION DE LECTURA ES 0X0000 (16BITS)
					CLRW								;LIMPIAMOS EL REGISTRO W = ; B'0000000'
					CALL			ENVIAR_DATO_SPI		;ENVIAR DATOS A LA MEMORIA 	B'00000000
					CLRW								;LIMPIAMOS EL REGISTRO W = ; B'0000000'
					CALL			ENVIAR_DATO_SPI		;ENVIAR DATOS A LA MEMORIA 	B'00000000', EMPIEZA A LEER DESDE LA DIRECCION 0X0000

LEER_32_BYTES:		CALL			ENVIAR_DATO_SPI		;ENVIAMOS DATO DUMMY PARA GENERAR LOS PULSOS DE RELOJ Y PODAMOS RECEPCIONAR LOS DATO QUE LLEGAN DE LA MEMORIA
		
					CALL			LEER_DATO_SPI		;LEEMOS EL DATO QUE NOS ENVIA EL SENSOR Y LO MOVEMOS AL REGISTRO W
					MOVWF			PORTD				;ENVIAMOS EL DATO RECIBIDO HACIA EL PUERTO D
					CALL			RETARDO_1S			;REPETIMOS LA LECTURA CADA 1 SEGUNDO
	
					DECFSZ			0X21,F				;SI EL NUMERO DE REGISTRO HA ENVIADO LOS 32 BYTES A LA MEMORIA?
					GOTO			LEER_32_BYTES		;LEER LOS 32 BYTES A LA MEMORIA
				
					BSF				PORTC,0				;ESCLAVO INACTIVO (MEMORIA DESACTIVADA)
				
					GOTO			LOOP				;VUELVE A LEER LA MEMORIA DESDE LA POSICION 0X0000
					
;*************************************************************************
					
;------------------SERVICIO DE RUTINA DE INTERRUPCION-----------------
;ISR:				
				
;FIN_INT:			RESTORE_REG							;RESTAURAMOS LOS REGISTROS DE INTERES
;					RETFIE								;REGRESAMOS DE LA INTERRUPCION
					
;-------------------------SUBRUTINAS----------------------------------
ENVIAR_DATO_SPI:	MOVWF			SSPBUF				;ENVIAR EL VALOR DEL PUERTOB AL BUFFER SPI
					BSF				STATUS,RP0			;BANCO 1
					BTFSS			SSPSTAT,BF			;SE ACTIVO LA BANDERA DE TRANSMISION?
					GOTO 			$-1					;NO SE ACTIVO, VUELVE A PREGUNTAR
					BCF				STATUS,RP0			;SI SE ACTIVO, CAMBIO DE BANCO 0
					RETURN
	
LEER_DATO_SPI:		MOVF			SSPBUF,W			;LEER LO QUE ESTA EN EL BUFFER SPI Y ENVIARLO A W
					RETURN

RETARDO_5MS:		RETARDO_2V		.4,.156				;RETARSO PARA 5MS
					RETURN

RETARDO_1S:			RETARDO_3V		.3,.234,.203		;RETARDO PARA 1S
;---------------------------TABLAS------------------------------------
;---------------------------LIBRERIAS--------------------------------
					INCLUDE		<D:\Archivos\Programacion\Microcontroladores\PIC\ASSEMBLER\MPASM\PIC16F887\LIBRERIAS\LIBRERIA_RETARDOS.asm>
;					INCLUDE		<D:\Archivos\Programacion\Microcontroladores\PIC\ASSEMBLER\MPASM\PIC16F887\LIBRERIAS\LIBRERIA_LCD.asm>		
					END
;*************************************************************************
;COMENTARIOS
;PARA USAR ANTIREBOTE COPIAR EN SUBRUTINA 	SUBT25MS:			RETARDO_3V		.3,.47,.25
;*************************************************************************
;PARA INICIALIZAR PANTALLA LCD: LLAMAR SUBRUTINA   INIT_LCD
;PARA ESCOJER UNA COLUMNA DE LA FILA1:  	FILA1_POSICION	.X		X: 0-15
;MOSTRAR MENSAJE LLAMA LA SUBRUTINA   		CALL		MENSAJE_FILA1
;PARA ESCOJER UNA COLUMNA DE LA FILA2:  	FILA1_POSICION	.X		X: 0-15
;MOSTRAR MENSAJE EN LA FILA 2 CON LA MACRO  	CALL		MENSAJE_FILA2