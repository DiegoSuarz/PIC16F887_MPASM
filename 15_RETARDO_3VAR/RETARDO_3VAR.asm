;DESCRIPCION:
;CALCULAS VALORES PARA CREAR UN RETARDO DE 1MS

			INCLUDE		<D:\Archivos\Programacion\Microcontroladores\PIC\ASSEMBLER\MPASM\PIC16F887\00_PLANTILLA\PLANTILLA.ASM>
			;NOS DEJA EN EL BANCO 1	
			
;ETIQUETAS | NEMONICOS | OPERANDOS 		| COMENTARIOS	
			CLRF		TRISD
			BCF			STATUS,RP0
			
LOOP:
			COMF		PORTD,F
			CALL		RETARDO_200MS
			CALL		RETARDO_193		;RETARDOS PARA 200MS
			GOTO		LOOP
									
;-------------------SUBRUTINA DE 2 VARIABLES-------------------------------------			
RETARDO_200MS:						
			MOVLW			
			MOVWF		0X64
			MOVLW		
			MOVWF		0X65
			MOVLW		
			MOVWF		0X66
			
ST3V:		MOVF		0X66,W
			MOVWF		0X67
RECARGA3V: 	MOVF		0X65,W
			MOVWF		0X68
						
DECRE3V:	NOP
			NOP
			NOP
			NOP
			DECFSZ		0X68,F
			GOTO		DECRE2V
			DECFSZ		0X61,F
			GOTO		RECARGA3V
			DECFSZ		0X64,F
			GOTO		ST3V
			RETURN
;-------------------SUBRUTINA DE 1 VARIABLE-------------------------------------						

;FORMULA PARA RUTINA DE 3 VARIABLES
;	
;	#CM = 9+(4)(VAR1)(1+
