
;DIRECTIVAS
			 PROCESSOR	16F887
		 	__CONFIG	0X2007,23E4
			__CONFIG	0X2008,3FFF
			INCLUDE		<P16F887.INC>
			ORG			0X0000			;DIRECTIVA ORG ,EMPEZAR EN LA DIRECCION 0 DE LA MEMORIA DE PROGRAMA
			GOTO		CONFIGURACION
;ETIQUETAS | NEMONICOS | OPERANDOS 		| COMENTARIOS			
CONFIGURACION
			BCF			STATUS,RP1
			BSF			STATUS,RP0		;ACCEDIENDO AL BANCO 1
			MOVLW		0XFF	
			MOVWF		TRISB			;PUERTO B COMO ENTRADA
			CLRF		TRISC			;PUERTO C COMO SALIDA
			MOVLW		0XFF
			MOVWF		WPUB			;PULL UP DESHABILITADAS
			
			BSF			STATUS,RP1
			CLRF		ANSELH			;ACCEDIENDO AL BANCO 3
		
			BCF			STATUS,RP0		
			BCF			STATUS,RP1		;ACCEDIENDO AL BANCO 0
			CLRF		PORTB			;LIMPIAR EL PUERTO B
			CLRF		PORTC			;LIMPIAR EL PUERTC

LOOP:	
			MOVF		PORTB,W
			MOVWF		PORTC
			GOTO		LOOP			;0X000D  , $-2
			END			;DIRECTIVA END