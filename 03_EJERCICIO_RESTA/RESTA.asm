;DESCRIPCION:
;Lea al puerto B, y reste 0x3c y el resultado salta por el Puerto c
;Propongo que al haber un puerto de salida, de origen saque 0x00
;DIRECTIVAS
			 PROCESSOR	16F887
		 	__CONFIG	0X2007,23E4
			__CONFIG	0X2008,3FFF
			INCLUDE		<P16F887.INC>

			ORG			0X0000			;EMPEZAR EN LA DIRECCION 0 DE LA MEMORIA DE PROGRAMA
			GOTO		CONFIGURACION
;ETIQUETAS | NEMONICOS | OPERANDOS 		| COMENTARIOS	

CONFIGURACION	

			BCF			STATUS,RP0		
			BCF			STATUS,RP1		;ACCEDIENDO AL BANCO 0
			CLRF		PORTA			;LIMPIAR EL PUERTO A
			CLRF		PORTB			;LIMPIAR EL PUERTO B
			CLRF		PORTC			;LIMPIAR EL PUERTO C
			CLRF		PORTD			;LIMPIAR EL PUERTO D
			CLRF		PORTE			;LIMPIAR EL PUERTO E
		
			BCF			STATUS,RP1
			BSF			STATUS,RP0		;ACCEDIENDO AL BANCO 1
			MOVLW		0XFF	
			MOVWF		TRISB			;PUERTO B COMO ENTRADA
			CLRF		TRISC			;PUERTO C COMO SALIDA
			MOVLW		0XFF
			MOVWF		WPUB			;PULL UP DESHABILITADAS
			
			BSF			STATUS,RP1
			CLRF		ANSELH			;ACCEDIENDO AL BANCO 3
		
			BCF			STATUS,RP0		
			BCF			STATUS,RP1		;ACCEDIENDO AL BANCO 0
			CLRF		PORTB			;LIMPIAR EL PUERTO B
			CLRF		PORTC			;LIMPIAR EL PUERTC
			
LOOP:	
			
			MOVLW		0X3C
			SUBWF		PORTB,W
			BTFSS		STATUS,C		;ES POSITIVO EL RESULTADO=
			SUBLW		.0				;SI EL NUMERO ES NEGATIVO, SACAR EL COMPLEMENTO A 2		 
			MOVWF		PORTC
			GOTO		LOOP			;0X000D  , $-2
			END			;DIRECTIVA END			
			


;SUBWF		F,D			RESULTADO=REG-W
;						RESULATDO=REG+C2(W)
;RECUERDA QUE AL HACER UNA RESTA 
;SI EL BIT DE ACARREO SE PONE EN 1, EL RESULTADO ES 0 -> POSITIVO
;SI EL BIT DE ACARREO SE PONE EN 0, EL RESULTADO ES NEGATIVO

;SUBLW		K			W = K - W
;						W = K + C2(W)
;SI K=0					W = 0 + C2(W)
;						W=C2(W)
 