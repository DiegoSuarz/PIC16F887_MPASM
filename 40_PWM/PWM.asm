;DESCRIPCION:
;DEBE TENER CONECTADO UN TECLADO MATRIVILA DE 4X4 EN EL PUERTO B, CUANDO
;SE APRIETE CUALQUIER TECHA DEBERA INTERRUMPIR Y GENERAR EN VALOR DISTINTO DE PWM 
;( A 1 KHZ) QUE SE MOSTRARA EN EL OSCILOSCOPIO

;EN EL PROGRAMA PRINCIPAL ESTARA DE FORMA PERMANENTE EL CONTADO DE
; 00 A 99 POR LOD DISPLAYS DE 7 SEGMENTOS.
;---------------------------MACROS----------------------------
;---------------------------DEFINE----------------------------
;----------------------------EQU------------------------------
CONT5		EQU 0X23
ALEATORIO	EQU	0X24
CONT_T0		EQU	0X28
DECIMAL		EQU 0X29
NUMERO		EQU 0X30

ESTADO_PB	EQU	0X2C
ES_NUEVO_PB EQU	0X2D

TECLADO4X4	EQU 0X2E
CONT_TECL	EQU	0X2F

;---------------------------CBLOCK----------------------------
CBLOCK		0X25
					UNIDADES,DECENAS,CENTENAS
			ENDC
;---------------------------HEADER----------------------------
					INCLUDE		<D:\Archivos\Programacion\Microcontroladores\PIC\ASSEMBLER\MPASM\PIC16F887\LIBRERIAS\MACROS_INTERRUPT.ASM>	;MACRO PARA EL USO DE INTERRUPCIONES
					;INCLUDE		<D:\Archivos\Programacion\Microcontroladores\PIC\ASSEMBLER\MPASM\PIC16F887\LIBRERIAS\MACROS_LCD.ASM>	;MACRO PARA EL USO DISPLAY LCD
					INCLUDE		<D:\Archivos\Programacion\Microcontroladores\PIC\ASSEMBLER\MPASM\PIC16F887\LIBRERIAS\MACROS_7SEG.ASM>	;MACRO PARA EL USO DISPLAY 7 SEG					
					INCLUDE		<D:\Archivos\Programacion\Microcontroladores\PIC\ASSEMBLER\MPASM\PIC16F887\LIBRERIAS\RETARDOS_MACROS.ASM> ;MACRO DE RETARDO
					INCLUDE		<D:\Archivos\Programacion\Microcontroladores\PIC\ASSEMBLER\MPASM\PIC16F887\LIBRERIAS\MACROS_CONFIGURACION_INT.ASM> ;MACRO DE CONFIGURACION BASICA
					ORG			0X0000			;EMPEZAR EN LA DIRECCION 0 DE LA MEMORIA DE PROGRAMA
					GOTO		INICIALIZA
					VECTOR_INTERRUPCION			;SI SE USA INTERRUPCIONES DESCOMENTAR
					SIETE_SG_KC				;SI SE USA DISPLAY 7 SEG DESCOMENTAR
					CONFIGURACION				;NOS DEJA EN EL BANCO 1
;-----------------------CODIGO PRINCIPAL------------------------------
;ETIQUETAS			|NEMONICOS		| OPERANDOS 		| COMENTARIOS	
					MOVLW			0XF0
					MOVWF			TRISB
					CLRF			TRISD
					BCF				TRISA,0
					BCF				TRISA,1
					MOVLW			0XFF
					MOVWF			WPUB				;HABILITANDO RESITENCIAS DE PULL UP PUERTO B

				
;************CONFIGURACION INTERRUPCION IOC***************************************
					BCF				OPTION_REG,7		;HABILITANDO RESISTENCIAS PULL UP PUERTO B
					COMF			IOCB,F				;PUERTO B IOC ACTIVADO
					
					
					
;************CONFIGURACION PWM PARA 1 KHZ**************************************************					
							
					MOVLW			.250
					MOVWF			PR2
					BCF				STATUS,RP0			;BANCO 0
					
					BSF				T2CON,T2CKPS0		;PRESCALER TMR2 = 4
				
					BSF				CCP1CON,3			;SE SELECCIONA CCP MODO PWM	
					BSF				CCP1CON,2

					CLRF			CCPR1L				;TPWM A 0%
					MOVLW			.60
					MOVWF			CCPR1L

					BCF				PIR1,TMR2IF			;BAJAR LA BANDERA DE INTERRUPCION 5MR2
			
					BSF				T2CON,TMR2ON		;ENCENDER TMR2

					BTFSS			PIR1,TMR2IF			;YA SE ACTIVO LA BANDERA TMR2?
					GOTO 			$-1

					BSF				STATUS,RP0			;BANCO 1
					BCF				TRISC,2				;ACTIVAR LA SALIDA DEL PWM
					BSF				STATUS,RP1			;BANCO 0					

					MOVF			PORTB,W				;LEER EL VALOR DEL PUERTO B, CONDICION DE LAS INTERRUPCIONES IOC
					BCF				INTCON,RBIF			;LIMPIAR BANDERA DE	IOC
					BSF				INTCON,RBIE			;HABILITAR INTERRUPCION IOC
					BSF				INTCON,GIE			;HABILITAR INTERRUPCIONES GLOBALES

;*************************************PROGRAMA PRINCIPAL************************************

LIMPIA_DEC:			CLRF			DECENA				;LIMPIAMOS LA VARIABLE DECENA (0X21)			
LIMPIA_UNI:			CLRF			UNIDAD				;LIMPIAMOS LA VARIABLE UNIDAD (0X20)

			
RECARGA60:			MOVLW			.60
					MOVWF			CONT60				;CARGARMOS LA VARIABLE CONT60 CON .60

VISUALIZAR:			MOVF			UNIDAD,W			;LEEMOS LA VARIABLE UNIDAD Y LO ALMACENAMOS EN W
					CALL			SIETE_SEG			;LLAMAMOS A LA RUTINA 7 SEG
					MOVWF			PORTD				;VISUALIZAMOS LA UNIDAD POR EL PUERTO D

					UNIDAD_ENA							;ENCENDER UNIDADES DISPLAY(ENCENDER TRANSITOR RA0)
					CALL			RETARDO_8mS
					UNIDAD_DIS							;ENCENDER UNIDADES DISPLAY(APAGAR TRANSITOR RA0)

					MOVF			DECENA,W			;LEEMOS LA VARIABLE UNIDAD Y LO ALMACENAMOS EN W
					CALL			SIETE_SEG			;LLAMAMOS A LA RUTINA 7 SEG
					MOVWF			PORTD				;VISUALIZAMOS LA DECENA POR EL PUERTO D

					DECENA_ENA							;ENCENDER DECENAS DISPLAY(ENCENDER TRANSITOR RA1)
					CALL			RETARDO_8mS
					DECENA_DIS							;APAGAR DECENAS DISPLAY(APAGAR TRANSITOR RA1)
			
					DECFSZ			CONT60,F			;BUCLE PARA REPETIR 60 VECES LA VISUALIZACION DE LOS DIGITOS
					GOTO			VISUALIZAR			
		
					INCF			UNIDAD,F			;INCREMENTAR LA VARIABLE UNIDAD
					MOVLW			0X09			
					XORWF			UNIDAD,W		
					BTFSS			STATUS,Z			;UNIDAD == 9?
					GOTO			RECARGA60			;NO, VE A REPETIR HASTA QUE SE CUMPLAN LOS 60 SIGLOS
					INCF			DECENA,F			;SI, INCREMENTA DECENA EN UNA UNIDAD, Y LIMPIA UNIDADES
					MOVLW			0X09
					XORWF			DECENA,W
					BTFSS			STATUS,Z			;DECENA == 9?
					GOTO			LIMPIA_UNI			;NO, VE A LIMPIAR UNIDADES, PERO MANTENER LAS DECENAS 
					GOTO			LIMPIA_DEC			;SI, VE Y LIMPIA UNIDADES Y DECENAS
					
;*************************************************************************
					
;------------------SERVICIO DE RUTINA DE INTERRUPCION-----------------
ISR:				
					
;**************************INTERRUPCION ON CHANGE*******************************				
					CALL			SUBT25MS			;RUTINA ANTIREBOTE
					MOVLW			0XF0
					ANDWF			PORTB,W			
					MOVWF			TECLADO4X4
				
					BCF				STATUS,RP0			;B1
					MOVLW			0X0F
					MOVWF			TRISB
					BCF				OPTION_REG,7		;DESACTIVAR PULL UP PUERTO B
					BCF				STATUS,RP0			;B0
					CLRF			PORTB

					MOVLW			0X0F
					ANDWF			PORTB,W
					ADDWF			TECLADO4X4,F		;VALORES CONCATENADOS PARA BUSCAR EN LA TABLA
					
					CLRF			CONT_TECL

BUSCA_TECLA:		MOVF			CONT_TECL,W
					CALL			TABLA_TECL
					XORWF			TECLADO4X4,W
					BTFSC			STATUS,Z
					GOTO			CAMBIA_PWM

					INCF			CONT_TECL,F
					MOVLW			.16
					XORWF			CONT_TECL,W
					BTFSS			STATUS,Z
					GOTO			BUSCA_TECLA
					MOVLW			.16
					MOVWF			CONT_TECL
				
CAMBIA_PWM:			MOVF			CONT_TECL,W		;NUEVO VALOR DUTY CYCLE
					CALL			TABLA_PWM

					MOVWF			CCPR1L
										
					MOVLW			0XF
					XORWF			PORTB,W
					BTFSS			STATUS,Z
					GOTO			$-3

					CALL			SUBT25MS
					BSF				STATUS,RP0			;B1
					MOVLW			0XF0
					MOVWF			TRISB
					BCF				OPTION_REG,7
					BCF				STATUS,RP0			;B0
					
					MOVF			PORTB,W
					BCF				INTCON,RBIF			;LIMPIAR BANDERA DE	IOC

FIN_INT:			RESTORE_REG							;RESTAURAMOS LOS REGISTROS DE INTERES
					RETFIE								;REGRESAMOS DE LA INTERRUPCION
					
;-------------------------SUBRUTINAS----------------------------------
BIN_A_DECIMAL:		CLRF			UNIDADES
					CLRF			DECENAS
					CLRF			CENTENAS

;************************EXTRAER CENTENAS*********************************
RESTA100:			MOVLW			.100
					SUBWF			NUMERO,F
					BTFSS			STATUS,C
					GOTO			SUMA100
					INCF			CENTENAS,F
					GOTO			RESTA100
SUMA100:			MOVLW			.100
					ADDWF			NUMERO,F

;******************EXTRAER DECENAS*********************************
RESTA10:			MOVLW			.10
					SUBWF			NUMERO,F
					BTFSS			STATUS,C
					GOTO			SUMA10
					INCF			DECENAS,F
					GOTO			RESTA10
SUMA10:				MOVLW			.10
					ADDWF			NUMERO,F

;******************EXTRAER UNIDADES********************************************************
					MOVF			NUMERO,W
					MOVWF			UNIDADES

								
;;***************DE BCD A DECIMAL USANDO CARACTERES ASCII*****************		
;					MOVLW			0X30				;EN CODIGO ASCII LOS NUMERO EMPIEZAN DESDE LA POSICION 0X30
;					ADDWF			UNIDADES,F
;					ADDWF			DECENAS,F
;					ADDWF			CENTENAS,F
;					RETURN
;
;IMPRIME_DECIMAL:	MOVF			CENTENAS,W
;					CALL			IMPRIME_CARACTER	;ESCRIBE CARACTER DE CENTENAS EN LA POSICION 14
;					MOVF			DECENAS,W						
;					CALL			IMPRIME_CARACTER	;ESCRIBE CARACTER DE DECENAS EN LA POSICION 15
;					MOVF			UNIDADES,W
;					CALL			IMPRIME_CARACTER	;ESCRIBE CARACTER DE UNIDADES EN LA POSICION 16
;					RETURN


SUBT25MS:			RETARDO_3V		.3,.47,.25
					RETURN

RETARDO_8mS:		RETARDO_2V		.6,.181			;RETARDO DE 8mS PARA LA PERSISTENCIA DE LA VISION
					RETURN
;---------------------------TABLAS------------------------------------
TABLA_TECL			ADDWF			PCL,F
					DT				0XEE,0XDE,0XBE,0X7E,0XED,0XDD, 0XBD, 0X7D,0XEB,0XDB,0XBB,0X7B,0XE7,0XD7,0XB7,0X77

TABLA_HEX_ASCII		ADDWF			PCL,F
					DT				"0123456789ABCDEF@"

TABLA_PWM			ADDWF			PCL,F
					DT				.0*.16,.1*.16,.2*.16,.3*.16,.4*.16,.5*.16,.6*.16,.7*.16,.8*.16,.9*.16,.10*.16,.11*.16,.12*.16,.13*.16,.14*.16,.15*.16,.255
;---------------------------LIBRERIAS--------------------------------
					INCLUDE		<D:\Archivos\Programacion\Microcontroladores\PIC\ASSEMBLER\MPASM\PIC16F887\LIBRERIAS\LIBRERIA_RETARDOS.asm>
			;		INCLUDE		<D:\Archivos\Programacion\Microcontroladores\PIC\ASSEMBLER\MPASM\PIC16F887\LIBRERIAS\LIBRERIA_LCD.asm>		
					END
;*************************************************************************
;COMENTARIOS
;PARA USAR ANTIREBOTE COPIAR EN SUBRUTINA 	SUBT25MS:			RETARDO_3V		.3,.47,.25
;*************************************************************************
;PARA INICIALIZAR PANTALLA LCD: LLAMAR SUBRUTINA   INIT_LCD
;PARA ESCOJER UNA COLUMNA DE LA FILA1:  	FILA1_POSICION	.X		X: 0-15
;MOSTRAR MENSAJE 1 LLAMAMOS A LA SUBRUTINA 	CALL			MENSAJE_FILA1
;PARA ESCOJER UNA COLUMNA DE LA FILA2:  	FILA2_POSICION	.X		X: 0-15
;MOSTRAR MENSAJE 2 LLAMAMOS A LA SUBRUTINA 	CALL			MENSAJE_FILA2