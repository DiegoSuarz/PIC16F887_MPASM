;--------------------------SUBRUTINAS--------------------------------
;PUERTO EQU PORTB
;PUERTO EQU PORTC
PUERTO	 EQU 	PORTC
;---------------------------DEFINE-----------------------------------
#DEFINE		RS_0	BCF		PUERTO,4
#DEFINE		RS_1	BSF		PUERTO,4
#DEFINE		E_0		BCF		PUERTO,5
#DEFINE		E_1		BSF		PUERTO,5

INIT_LCD:			RETARDO_2V		.61,.232			;100mS
					CALL			MINISALUDO
					CALL			MINISALUDO
					CALL			MINISALUDO
					MOVLW			B'00000010'
					MOVWF			PUERTO
					CALL			ACTIVA_E
					CALL			FUNCTION_SET
					CALL			LCD_OFF
					CALL			LIMPIA_LCD
					CALL			ENTRY_MODE
					CALL			LCD_ON	
					RETURN					 			

FUNCTION_SET:		MOVLW			B'00101000'			;4BITS, 2FILAS, 5X7 PIXELS	
					GOTO			ESCRIBE_DATO

LCD_OFF:			MOVLW			B'00001000'			
					GOTO			ESCRIBE_DATO

LIMPIA_LCD:			MOVLW			B'00000001'
					GOTO			ESCRIBE_DATO

ENTRY_MODE:			MOVLW			B'00000110'			;NO RECORRE INFORMACION AL ESCRIBIR,APUNTADOR CON INCREMENTE
					GOTO			ESCRIBE_DATO

LCD_ON:				MOVLW			B'00001100'
					GOTO			ESCRIBE_DATO

LCD_ON_CURSOR:		MOVLW			B'00001110'
					GOTO			ESCRIBE_DATO	

LCD_ON_CURS_BLINK:  MOVLW			B'00001111'
					GOTO			ESCRIBE_DATO

HOME:				MOVLW			B'00000010'
					GOTO			ESCRIBE_DATO	

RECORRE_DER_LCD:	MOVLW			B'00011100'
					GOTO			ESCRIBE_DATO	

RECORRE_IZQ_LCD:	MOVLW			B'00011000'
					GOTO			ESCRIBE_DATO	

RECORRE_DER_CUR:	MOVLW			B'00010100'
					GOTO			ESCRIBE_DATO	

RECORRE_IZQ_CUR:	MOVLW			B'00010000'
					GOTO			ESCRIBE_DATO

DIRECCION_DDRAM:	IORLW			B'10000000'
					GOTO			ESCRIBE_DATO
	
IMPRIME_CARACTER:	MOVWF			DATO
					SWAPF			DATO,W
					ANDLW			B'00001111'
					MOVWF			PUERTO
					RS_1
					CALL			ACTIVA_E			;ENVIAR LOS 4BITS MSB
					MOVF			DATO,W
					ANDLW			B'00001111'
					MOVWF			PUERTO
					RS_1
					CALL			ACTIVA_E			;ENVIAR LOS 4BITS LSB
					RETURN 

ESCRIBE_DATO:		MOVWF			DATO
					SWAPF			DATO,W
					ANDLW			B'00001111'
					MOVWF			PUERTO
					CALL			ACTIVA_E			;ENVIAR LOS 4BITS MSB
					MOVF			DATO,W
					ANDLW			B'00001111'
					MOVWF			PUERTO
					CALL			ACTIVA_E			;ENVIAR LOS 4BITS LSB
					RETURN 

					
MINISALUDO:			MOVLW			B'00000011'
					MOVWF			PUERTO
					CALL			ACTIVA_E
					RETARDO_2V		.4,.156				;5mS
					RETURN

ACTIVA_E:			E_1
					NOP
					NOP
					NOP
					NOP
					NOP
					E_0
					RETARDO_2V		.35,.8
					RETURN



;-------------------SUBRUTINA PARA ESCRIBIR MENSAJES------------------------------------------------------------------------------------

		
MENSAJE_FILA1				CLRF			0X20
TABLA1:				MOVF			0X20,W
					CALL			LCD_FILA1
					CALL			IMPRIME_CARACTER
					INCF			0X20,F
					MOVLW			.16
					XORWF			0X20,W
					BTFSS			STATUS,Z
					GOTO			TABLA1
					RETURN					


MENSAJE_FILA2				CLRF			0X20
TABLA2: 			MOVF			0X20,W
					CALL			LCD_FILA2
					CALL			IMPRIME_CARACTER
					INCF			0X20,F
					MOVLW			.16
					XORWF			0X20,W
					BTFSS			STATUS,Z
					GOTO			TABLA2
					RETURN



