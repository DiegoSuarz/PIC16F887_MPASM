;DESCRIPCION:
;DIBUJA UNA CARITA FELIZ EN LA MATRIZ
;PORTC=RENGLONES, ACTIVAS LOS DATOS CON 0s
;PORTB=DATOS
;---------------------------MACROS-----------------------------------
;CARGA_ANIMA		 	MACRO			ETIQUETA,RETARDOS,NUM_ANIM	;MACRO PARA GENERAR ANIMACIONES Y RETARDO
;					MOVLW			RETARDOS					;CUANTAS REPETICIONES HACER PARA GENERAR UN RETARDO PARA 1/60 DE SEG
;					MOVWF			REPETICIONES				;CARGAR EN NUMERO DE REPETICIONES PARA GENERAR UN CAMBIO.
;ETIQUETA:			MOVLW			8*NUM_ANIM					;MPLAB CARGA 8 * NUM_ANIM QUE SE REQUIERA, NUM_ANIM=0,1,2,3
;					MOVWF			NUMERO_ANIMACION			;EL NUMERO DE ANIMACION GENERADO DE ACUERDO A LA TABLA
;					CALL			ANIMACIONES					;LLAMADO A SUBRUTINA
;					DECFSZ			REPETICIONES,F				;GENERAR RETARDO
;					GOTO			ETIQUETA
;					ENDM
;---------------------------DEFINE-----------------------------------

;----------------------------EQU--------------------------------------
NUMERO_ANIMACION	EQU	0X21
CONTEO_RENGLONES	EQU 0X22
REPETICIONES		EQU 0X23

;---------------------------HEADER--------------------------------------
					
					INCLUDE		<D:\Archivos\Programacion\Microcontroladores\PIC\ASSEMBLER\MPASM\PIC16F887\LIBRERIAS\RETARDOS_MACROS.ASM> ;MACRO DE RETARDO
					INCLUDE		<D:\Archivos\Programacion\Microcontroladores\PIC\ASSEMBLER\MPASM\PIC16F887\LIBRERIAS\PLANTILLA.ASM>	;CONFIGURACION BASICA

CARGA_ANIMA		 	MACRO			ETIQUETA,RETARDOS,NUM_ANIM	;MACRO PARA GENERAR ANIMACIONES Y RETARDO
				
					MOVLW			RETARDOS					;CUANTAS REPETICIONES HACER PARA GENERAR UN RETARDO PARA 1/60 DE SEG
					MOVWF			REPETICIONES				;CARGAR EN NUMERO DE REPETICIONES PARA GENERAR UN CAMBIO.
ETIQUETA:			MOVLW			8*NUM_ANIM					;MPLAB CARGA 8 * NUM_ANIM QUE SE REQUIERA, NUM_ANIM=0,1,2,3
					MOVWF			NUMERO_ANIMACION			;EL NUMERO DE ANIMACION GENERADO DE ACUERDO A LA TABLA
					CALL			ANIMACIONES					;LLAMADO A SUBRUTINA
					DECFSZ			REPETICIONES,F				;GENERAR RETARDO
					GOTO			ETIQUETA
					ENDM

			;NOS DEJA EN EL BANCO 1	

;-----------------------CODIGO PRINCIPAL------------------------------
;ETIQUETAS			|NEMONICOS		| OPERANDOS 		| COMENTARIOS	
					CLRF			TRISB				;PUERTO B COMO SALIDA
					CLRF			TRISC				;PUERTO C COMO SALIDA
					BCF				STATUS,RP0			;ACCEDER AL BANCO 0
					COMF			PORTC,F				;PONER 0XFF EL PUERTO C	

REINICIO_ANIMACIONES:			
					CARGA_ANIMA		ANIMACION_0,.60,2 	;LLAMA MACRO, RETARDO = 1000MS, Y CARGA EL NUMERO DE ANIMACION 2	
					CARGA_ANIMA		ANIMACION_1,.120,0 	;LLAMA MACRO, RETARDO = 2000MS, Y CARGA EL NUMERO DE ANIMACION 0
					CARGA_ANIMA		ANIMACION_2,.30,0 	;LLAMA MACRO, RETARDO = 500MS, Y CARGA EL NUMERO DE ANIMACION 3
					CARGA_ANIMA		ANIMACION_3,.60,1 	;LLAMA MACRO, RETARDO = 1000MS, Y CARGA EL NUMERO DE ANIMACION 0
					GOTO			REINICIO_ANIMACIONES	
							
;--------------------------SUBRUTINAS--------------------------------

ANIMACIONES:		CLRF			CONTEO_RENGLONES
					MOVF			NUMERO_ANIMACION,W	;CARGAR A W CON EL VALOR DE LA VARIABLE NUMERO_ANIMACION
					MOVWF			0X20				;CARGAR LA DIRECCION DE RAM 0X20 CON EL VALOR DE LA VARIABLE NUMERO_ANIMACION
SACA_DATOS:			MOVF			0X20,W				;CONTENIDO DE 0X20 -> W
					CALL			ANIMACION__0			;LLAMAR A TABLA ANIMACION
					MOVWF			PORTB				;VALOR RETORNADO DE TABLA A PUERTO B
					
					MOVF			CONTEO_RENGLONES,W	;LEER EL CONTENIDO DE DIRECCION 0X20 RAM
					CALL			RENGLONES			;LLAMAR A TABLA RENGLONES
					MOVWF			PORTC				;VALOR RETORNADO DE TABLA A PUERTO C
					
					RETARDO_3V		.1,.2,.115			;RETARDO DE 208us (PERSISTENCIA DE LA VISION) 1/(60*8) = 1/480 = 208us
					MOVLW			0XFF				
					MOVWF			PORTC				;PUERTO C = 0XFF, APAGA TODOS LOS RENGLONES
					
					INCF			0X20,F				;INCREMENTO EL CONTENIDO DE 0X20 DE LA RAM EN UNA UNIDAD Y LO ALMACENO EN W
					INCF			CONTEO_RENGLONES,F
					MOVLW			.8			
					XORWF			CONTEO_RENGLONES,W	;CONTENIDO DE LA DIR 0X20 DE RAM XOR W
					BTFSS			STATUS,Z			;CONTENIDO DE LA DIR 0X20 DE RAM ==8?
					GOTO			SACA_DATOS			;NO, VISULALIZA DATOS EN LA MATRIZ DE LEDS
					RETURN		
							


;---------------------------TABLAS--------------------------------

RENGLONES:			ADDWF			PCL,F				;CONTROL DE RENGLONES SE ACTIVA 1 BIT DEL PUERTO C A LA VEZ
					DT				.254,.253,.251,.247,.239,.223,.191,.127
					
ANIMACION__0:		ADDWF			PCL,F			
					DT				.0,.36,.36,.36,.129,.66,.60,.0		;CONTROL DE ANIMACION DE CARITA FELIZ SALE POR EL PUERTO B
ANIMACION__1:		DT				.0,.0,.102,.0,.129,.66,.60,.0 		;CONTROL DE ANIMACION DE CARITA FELIZ SALE POR EL PUERTO B, SE LE LLAMA CON W = 8
ANIMACION__2:		DT				.0,.36,.36,.36,.0,.0,.126,.0		;CONTROL DE ANIMACION DE CARITA SERIA SALE POR EL PUERTO B, SE LE LLAMA CON W = 15				
ANIMACION__3:		DT				.165,.66,.165,.0,.0,.0,.126,.129	;CONTROL DE ANIMACION DE CARITA TRISTE SALE POR EL PUERTO B, SE LE LLAMA CON W = 23

;---------------------------LIBRERIAS--------------------------------
					INCLUDE		<D:\Archivos\Programacion\Microcontroladores\PIC\ASSEMBLER\MPASM\PIC16F887\LIBRERIAS\RETARDOS.asm>
						
					END