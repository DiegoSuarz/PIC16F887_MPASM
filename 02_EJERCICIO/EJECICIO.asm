;DESCRIPCION:
;Lea al puerto B, le sume 0x54 y el resultado salta por el Puerto c
;Propongo que al haber un puerto de salida, de origen saque 0x00
;DIRECTIVAS
			 PROCESSOR	16F887
		 	__CONFIG	0X2007,23E4
			__CONFIG	0X2008,3FFF
			INCLUDE		<P16F887.INC>

			ORG			0X0000			;EMPEZAR EN LA DIRECCION 0 DE LA MEMORIA DE PROGRAMA
			GOTO		CONFIGURACION
;ETIQUETAS | NEMONICOS | OPERANDOS 		| COMENTARIOS	

CONFIGURACION		
BCF			STATUS,RP1
			BSF			STATUS,RP0		;ACCEDIENDO AL BANCO 1
			MOVLW		0XFF	
			MOVWF		TRISB			;PUERTO B COMO ENTRADA
			CLRF		TRISC			;PUERTO C COMO SALIDA
			MOVLW		0XFF
			MOVWF		WPUB			;PULL UP DESHABILITADAS
			
			BSF			STATUS,RP1
			CLRF		ANSELH			;ACCEDIENDO AL BANCO 3
		
			BCF			STATUS,RP0		
			BCF			STATUS,RP1		;ACCEDIENDO AL BANCO 0
			CLRF		PORTB			;LIMPIAR EL PUERTO B
			CLRF		PORTC			;LIMPIAR EL PUERTC

LOOP:	
			MOVF		PORTB,W
			MOVLW		0X54
			ADDWF		PORTB,0
			MOVWF		PORTC
			GOTO		LOOP			;0X000D  , $-2
			END			;DIRECTIVA END			
			
LOOP:	
			GOTO		LOOP
			END			;DIRECTIVA END