;DESCRIPCION:
;CREAR UNA SECUENCIA DE SONIDOS, CAMBIANDO DE SONIDO CADA QUE SE APRIETE
;UN INTERRUPTOR CONECTADO AL RE0
;(EL SONIDO DEBE SALIR POR RE1)
;LAS FRECUENCIAS SON: 330Hz (T/2 = 1515 uS )
;262 Hz (T/2 = 1908 uS ),  392 Hz (T/2 = 1275 uS )Y 192 Hz  (T/2 = 2604 uS ).		
			INCLUDE		<D:\Archivos\Programacion\Microcontroladores\PIC\ASSEMBLER\MPASM\PIC16F887\LIBRERIAS\MACROS_RETARDO.ASM> ;MACRO DE RETARDO
			INCLUDE		<D:\Archivos\Programacion\Microcontroladores\PIC\ASSEMBLER\MPASM\PIC16F887\LIBRERIAS\PLANTILLA.ASM>	;CONFIGURACION BASICA

			;NOS DEJA EN EL BANCO 1	
					
;---------------------------MACROS-----------------------------------
PUSH_ANTIR	MACRO	PUERTO,BIT
			BTFSS	PUERTO,BIT
			GOTO	$-1
			CALL	T25MS
			BTFSC 	PUERTO,BIT 
			GOTO	$-1
			CALL	T25MS
			ENDM
			
SUBT25MS	MACRO
T25MS:		SUBT3V	.3,.47,.25
			RETURN
			ENDM
;---------------------------DEFINE--------------------------------------

;---------------------------CODIGO PRINCIPAL-----------------------------
	
;ETIQUETAS | NEMONICOS | OPERANDOS 		| COMENTARIOS	
			BCF			TRISE,1
			BCF			STATUS,RP0		;BANCO 0

INICIO:		
			PUSH_ANTIR	PORTE,0
			CALL		SONIDO_1	
			PUSH_ANTIR	PORTE,0
			CALL		SONIDO_1	
			PUSH_ANTIR	PORTE,0
			CALL		SONIDO_1	

SONIDO_2	BSF			PORTE,1		
			SUBT2V		.3,.76			;1515 uS	(DESEADO -1 CICLO)
			BCF			PORTE,1
			SUBT3V		.5,.13,.15		;1512 uS	DESEADO -4(CICLOS)
			BTFSS		PORTE,0
			GOTO		SONIDO_2

			PUSH_ANTIR	PORTE,0
			CALL		SONIDO_1
 

SONIDO_3	BSF			PORTE,1		
			SUBT3V		.5,.35,.1		;1274 uS	(DESEADO -1 CICLO)
			BCF			PORTE,1
			SUBT3V		.1,.10,.17		;1271 uS	DESEADO -4(CICLOS)
			BTFSS		PORTE,0
			GOTO		SONIDO_3
			
			PUSH_ANTIR	PORTE,0
			CALL		SONIDO_1

SONIDO_4	BSF			PORTE,1		
			SUBT2V		.1,.236			;2603 uS	(DESEADO -1 CICLO)
			BCF			PORTE,1	
			SUBT2V		.2,.144			;2600  uS	(DESEADO -4(CICLOS)
			NOP
			BTFSS		PORTE,0
			GOTO		SONIDO_4
			GOTO		INICIO

;--------------------------SUBRUTINAS-------------------------			
			
SONIDO_1:	BSF			PORTE,1		
			SUBT2V		.1,.137			;1515 uS	(DESEADO -1 CICLO)
			BCF			PORTE,1
			SUBT2V		.4,.75			;1511 uS	DESEADO -4(CICLOS)
			BTFSS		PORTE,0
			GOTO		SONIDO_1
			RETURN
			
SUBT25MS
			INCLUDE		<D:\Archivos\Programacion\Microcontroladores\PIC\ASSEMBLER\MPASM\PIC16F887\LIBRERIAS\RETARDOS.asm>
					
			END