;PLANTILLA PARA CONFIGURACION BASICA

;DESCRIPCION:
;Lea al puerto B, y reste 0x3c y el resultado salta por el Puerto c
;Propongo que al haber un puerto de salida, de origen saque 0x00
;DIRECTIVAS
			 PROCESSOR	16F887
		 	__CONFIG	0X2007,23E4
			__CONFIG	0X2008,3FFF
			INCLUDE		<P16F887.INC>

			ORG			0X0000			;EMPEZAR EN LA DIRECCION 0 DE LA MEMORIA DE PROGRAMA
			GOTO		CONFIGURACION
;ETIQUETAS | NEMONICOS | OPERANDOS 		| COMENTARIOS	

CONFIGURACION	
			
	                BSF			STATUS,RP0
			BSF			STATUS,RP1		;ACCEDIENDO AL BANCO 3
			CLRF		ANSEL
			CLRF		ANSELH			;TODOS LOS PINES DIGITALES
			
			BCF			STATUS,RP1
			BSF			STATUS,RP0		;ACCEDIENDO AL BANCO 1
			CLRF		TRISA			;PUERTO B COMO ENTRADA
			CLRF		TRISB			;PUERTO C COMO SALIDA
			CLRF		TRISC			;PUERTO B COMO ENTRADA
			CLRF		TRISD			;PUERTO C COMO SALIDA
			CLRF		TRISE			;PUERTO B COMO ENTRADA
			

			BCF			STATUS,RP0		
			BCF			STATUS,RP1		;ACCEDIENDO AL BANCO 0
			CLRF		PORTA			;LIMPIAR EL PUERTO A
			CLRF		PORTB			;LIMPIAR EL PUERTO B
			CLRF		PORTC			;LIMPIAR EL PUERTO C
			CLRF		PORTD			;LIMPIAR EL PUERTO D
			CLRF		PORTE			;LIMPIAR EL PUERTO E
		
			BCF			STATUS,RP1
			BSF			STATUS,RP0		;ACCEDIENDO AL BANCO 1
			