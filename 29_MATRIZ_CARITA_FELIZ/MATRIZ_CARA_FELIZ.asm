;DESCRIPCION:
;DIBUJA UNA CARITA FELIZ EN LA MATRIZ
;PORTC=RENGLONES, ACTIVAS LOS DATOS CON 0s
;PORTB=DATOS
;---------------------------MACROS-----------------------------------

;---------------------------DEFINE-----------------------------------

;----------------------------EQU--------------------------------------

;---------------------------HEADER--------------------------------------
					
			INCLUDE		<D:\Archivos\Programacion\Microcontroladores\PIC\ASSEMBLER\MPASM\PIC16F887\LIBRERIAS\RETARDOS_MACROS.ASM> ;MACRO DE RETARDO
			INCLUDE		<D:\Archivos\Programacion\Microcontroladores\PIC\ASSEMBLER\MPASM\PIC16F887\LIBRERIAS\PLANTILLA.ASM>	;CONFIGURACION BASICA

			;NOS DEJA EN EL BANCO 1	

;-----------------------CODIGO PRINCIPAL------------------------------
;ETIQUETAS			|NEMONICOS		| OPERANDOS 		| COMENTARIOS	
					CLRF			TRISB				;PUERTO B COMO SALIDA
					CLRF			TRISC				;PUERTO C COMO SALIDA
					BCF				STATUS,RP0			;ACCEDER AL BANCO 0
					COMF			PORTC,F				;PONER 0XFF EL PUERTO C
					
REINICIA:			CLRF			0X20				;BORRAR LA DIRECCION DE MEMORIA RAM 0X20
SACA_DATOS:			MOVF			0X20,W				;CONTENIDO DE 0X20 -> W
					CALL			ANIMACION_1			;LLAMAR A TABLA ANIMACION
					MOVWF			PORTB				;VALOR RETORNADO DE TABLA A PUERTO B
					
					MOVF			0X20,W				;LEER EL CONTENIDO DE DIRECCION 0X20 RAM
					CALL			RENGLONES			;LLAMAR A TABLA RENGLONES
					MOVWF			PORTC				;VALOR RETORNADO DE TABLA A PUERTO C
					
					RETARDO_3V		.1,.2,.115			;RETARDO DE 208us (PERSISTENCIA DE LA VISION) 1/(60*8) = 1/480 = 208us
					MOVLW			0XFF				
					MOVWF			PORTC				;PUERTO C = 0XFF
					
					INCF			0X20,F				;INCREMENTO EL CONTENIDO DE 0X20 DE LA RAM EN UNA UNIDAD Y LO ALMACENO EN W
					MOVLW			.8			
					XORWF			0X20,W				;CONTENIDO DE LA DIR 0X20 DE RAM XOR W
					BTFSS			STATUS,Z			;CONTENIDO DE LA DIR 0X20 DE RAM ==8?
					GOTO			SACA_DATOS			;NO, VISULALIZA DATOS EN LA MATRIZ DE LEDS
					GOTO			REINICIA			;SI, REINICIA EL CONTENIDO DE RAM 0X20, Y VUELVE A SACAR LOS VALORE EN LA MATRIZ DE LEDS
							
;--------------------------SUBRUTINAS--------------------------------
RENGLONES:			ADDWF			PCL,F				;CONTROL DE RENGLONES SE ACTIVA 1 BIT DEL PUERTO C A LA VEZ
					DT				.254,.253,.251,.247,.239,.223,.191,.127
					
ANIMACION_1:		ADDWF			PCL,F				;CONTROL DE ANIMACION DE CARITA FELIZ SALE POR EL PUERTO B
					DT				.0,.36,.36,.36,.129,.66,.60,.0

;---------------------------LIBRERIAS--------------------------------
			INCLUDE		<D:\Archivos\Programacion\Microcontroladores\PIC\ASSEMBLER\MPASM\PIC16F887\LIBRERIAS\RETARDOS.asm>
					
			END