;DESCRIPCION:
;USANDO EL TIMER 0 COMO FUENTE DE INTERRUPCION,
;DEBE CONTAR EVENTOS POR LA TERMINAL RA4,
;AL LLEGAR A 2500 DEBE EMITIR UN TONO DE 1KHZ(RC2) DURANTE 500ms
;EN EL PROGRAMA PRINCIPAL ESTARа DE FORMA PERMANENTE EL CONTADOR DE 
;00 A 99 POR LOS DISPLAYS DE 7 SEGMENTOS, PERO ESTA SECUENCIA TAMBIиN
;PUEDE SER INTERRUPIDA POR RB0/INT, AL ENTRAR A LA INTERRUPCION 
;GENERARа EL NUMERO ALEATORIO Y LO IMPRIMIRа EN LA LCD
;---------------------------MACROS----------------------------
;---------------------------DEFINE----------------------------
;----------------------------EQU------------------------------
CONT5		EQU 0X23
ALEATORIO	EQU	0X24
CONT_T0		EQU	0X28
DECIMAL		EQU 0X29
NUMERO		EQU 0X30
;---------------------------CBLOCK----------------------------
CBLOCK		0X25
					UNIDADES,DECENAS,CENTENAS
			ENDC
;---------------------------HEADER----------------------------
					INCLUDE		<D:\Archivos\Programacion\Microcontroladores\PIC\ASSEMBLER\MPASM\PIC16F887\LIBRERIAS\MACROS_INTERRUPT.ASM>	;MACRO PARA EL USO DE INTERRUPCIONES
					INCLUDE		<D:\Archivos\Programacion\Microcontroladores\PIC\ASSEMBLER\MPASM\PIC16F887\LIBRERIAS\MACROS_LCD.ASM>	;MACRO PARA EL USO DISPLAY LCD
					INCLUDE		<D:\Archivos\Programacion\Microcontroladores\PIC\ASSEMBLER\MPASM\PIC16F887\LIBRERIAS\MACROS_7SEG.ASM>	;MACRO PARA EL USO DISPLAY 7 SEG					
					INCLUDE		<D:\Archivos\Programacion\Microcontroladores\PIC\ASSEMBLER\MPASM\PIC16F887\LIBRERIAS\RETARDOS_MACROS.ASM> ;MACRO DE RETARDO
					INCLUDE		<D:\Archivos\Programacion\Microcontroladores\PIC\ASSEMBLER\MPASM\PIC16F887\LIBRERIAS\MACROS_CONFIGURACION_INT.ASM> ;MACRO DE CONFIGURACION BASICA
					ORG			0X0000			;EMPEZAR EN LA DIRECCION 0 DE LA MEMORIA DE PROGRAMA
					GOTO		INICIALIZA
					VECTOR_INTERRUPCION			;SI SE USA INTERRUPCIONES DESCOMENTAR
					SIETE_SG_KC				;SI SE USA DISPLAY 7 SEG DESCOMENTAR
					
;************************************************************************                *************************************************************************
TABLA_LCD			ADDWF			PCL,F
LCD_FILA1			ADDWF			PCL,F
					DT				"EL NUMERO       "
LCD_FILA2			ADDWF			PCL,F
					DT				"ALEATORIO ES    "						
					CONFIGURACION				;NOS DEJA EN EL BANCO 1
;-----------------------CODIGO PRINCIPAL------------------------------
;ETIQUETAS			|NEMONICOS		| OPERANDOS 		| COMENTARIOS	
					CLRF			TRISB
					CLRF			TRISD
					BCF				TRISA,0
					BCF				TRISA,1

					BCF				STATUS,RP0			;BANCO 0
					CALL			INIT_LCD	
					FILA1_POSICION	.0
					CALL			MENSAJE_FILA1
					FILA2_POSICION	.0
					CALL			MENSAJE_FILA2

					BSF				STATUS,RP0			;BANCO 1
					COMF			TRISB,F				;PUERTO B COMO ENTRADA
;************CONFIGURACION INTERRUPCION EXTERNA***************************************
					MOVLW			B'11010101'			;RB0 INT, FLACOS DE SUBIDA,TEMPORIZADOR, PRES=64
					MOVWF			OPTION_REG
					BCF				STATUS,RP0			;BANCO 0
					
					CLRF			CONT_T0
					MOVLW			.131				;TIMER CUENTA A 125 X 64 PREE = 8000
					MOVWF			TMR0
					
					MOVLW			.125
					MOVWF			CONT5

					BCF				INTCON,T0IF			;LIMPIAR BANDERA DE INTERRUPCION
					BSF				INTCON,T0IE			;HABILITAR INTERRUPCION EXTERNA
					BCF				INTCON,INTF			;LIMPIAR BANDERA DE INTERRUPCION
					BSF				INTCON,INTE			;HABILITAR INTERRUPCION EXTERNA
					BSF				INTCON,GIE			;HABILITAR INTERRUPCIONES GLOBALES
;*************************************************************************
LIMPIA_DEC:			CLRF			DECENA				;LIMPIAMOS LA VARIABLE DECENA (0X21)			
LIMPIA_UNI:			CLRF			UNIDAD				;LIMPIAMOS LA VARIABLE UNIDAD (0X20)

			
RECARGA60:			MOVLW			.60
					MOVWF			CONT60				;CARGARMOS LA VARIABLE CONT60 CON .60

VISUALIZAR:			MOVF			UNIDAD,W			;LEEMOS LA VARIABLE UNIDAD Y LO ALMACENAMOS EN W
					CALL			SIETE_SEG			;LLAMAMOS A LA RUTINA 7 SEG
					MOVWF			PORTD				;VISUALIZAMOS LA UNIDAD POR EL PUERTO D

					UNIDAD_ENA							;ENCENDER UNIDADES DISPLAY(ENCENDER TRANSITOR RA0)
					CALL			RETARDO_8mS
					UNIDAD_DIS							;ENCENDER UNIDADES DISPLAY(APAGAR TRANSITOR RA0)

					MOVF			DECENA,W			;LEEMOS LA VARIABLE UNIDAD Y LO ALMACENAMOS EN W
					CALL			SIETE_SEG			;LLAMAMOS A LA RUTINA 7 SEG
					MOVWF			PORTD				;VISUALIZAMOS LA DECENA POR EL PUERTO D

					DECENA_ENA							;ENCENDER DECENAS DISPLAY(ENCENDER TRANSITOR RA1)
					CALL			RETARDO_8mS
					DECENA_DIS							;APAGAR DECENAS DISPLAY(APAGAR TRANSITOR RA1)
			
					DECFSZ			CONT60,F			;BUCLE PARA REPETIR 60 VECES LA VISUALIZACION DE LOS DIGITOS
					GOTO			VISUALIZAR			
		
					INCF			UNIDAD,F			;INCREMENTAR LA VARIABLE UNIDAD
					MOVLW			0X09			
					XORWF			UNIDAD,W		
					BTFSS			STATUS,Z			;UNIDAD == 9?
					GOTO			RECARGA60			;NO, VE A REPETIR HASTA QUE SE CUMPLAN LOS 60 SIGLOS
					INCF			DECENA,F			;SI, INCREMENTA DECENA EN UNA UNIDAD, Y LIMPIA UNIDADES
					MOVLW			0X09
					XORWF			DECENA,W
					BTFSS			STATUS,Z			;DECENA == 9?
					GOTO			LIMPIA_UNI			;NO, VE A LIMPIAR UNIDADES, PERO MANTENER LAS DECENAS 
					GOTO			LIMPIA_DEC			;SI, VE Y LIMPIA UNIDADES Y DECENAS
					
;*************************************************************************
					
;------------------SERVICIO DE RUTINA DE INTERRUPCION-----------------
ISR:				;CLRF			PORTA
					BTFSS			INTCON,T0IF
					GOTO			INT_EXT

;**************************INTERRUPCION TMR0*******************************
					DECFSZ			CONT5,F
					GOTO            CLR_FLAG
					

					BSF				STATUS,RP0
					COMF			TRISB,F
					BCF				STATUS,RP0

					MOVLW			.125
					MOVWF			CONT5
					
					INCF			CONT_T0,F
					MOVF			CONT_T0,W
					MOVWF			NUMERO
					CALL			BIN_A_DECIMAL
				

;**************************IMPRIMIMOS CARACTERES EN EL LCD***************************************************						
					FILA1_POSICION	.13					;UBICAMOS EL CURSOR EN LA FILA 2 COLUMNA 14
					CALL			IMPRIME_DECIMAL 

CLR_FLAG:			MOVLW			.131
					MOVWF			TMR0
					BCF				INTCON,T0IF			;LIMPIAMOS LA BANDERA DE INTERRUPCION INT_EXT	
					BCF				INTCON,INTF	
					GOTO			FIN_INT

					
;**************************INTERRUPCION EXTERNA*******************************				
INT_EXT				CLRF			PORTA
					CALL			SUBT25MS
					INCF			ALEATORIO,F
					BTFSC			PORTB,0
					GOTO			$-2
					CALL			SUBT25MS

					MOVF			ALEATORIO,W
					MOVWF			NUMERO
					CALL			BIN_A_DECIMAL
				
					BSF				STATUS,RP0
					COMF			TRISB,F
					BCF				STATUS,RP0

;**************************IMPRIMIMOS CARACTERES EN EL LCD***************************************************						
					FILA2_POSICION	.13					;UBICAMOS EL CURSOR EN LA FILA 2 COLUMNA 14
					
					CALL			IMPRIME_DECIMAL
				
					BCF				INTCON,INTF			;LIMPIAMOS LA BANDERA DE INTERRUPCION INT_EXT	
					
FIN_INT:			RESTORE_REG							;RESTAURAMOS LOS REGISTROS DE INTERES
					RETFIE								;REGRESAMOS DE LA INTERRUPCION
					
;-------------------------SUBRUTINAS----------------------------------
BIN_A_DECIMAL:		CLRF			UNIDADES
					CLRF			DECENAS
					CLRF			CENTENAS

;************************EXTRAER CENTENAS*********************************
RESTA100:			MOVLW			.100
					SUBWF			NUMERO,F
					BTFSS			STATUS,C
					GOTO			SUMA100
					INCF			CENTENAS,F
					GOTO			RESTA100
SUMA100:			MOVLW			.100
					ADDWF			NUMERO,F

;******************EXTRAER DECENAS*********************************
RESTA10:			MOVLW			.10
					SUBWF			NUMERO,F
					BTFSS			STATUS,C
					GOTO			SUMA10
					INCF			DECENAS,F
					GOTO			RESTA10
SUMA10:				MOVLW			.10
					ADDWF			NUMERO,F

;******************EXTRAER UNIDADES********************************************************
					MOVF			NUMERO,W
					MOVWF			UNIDADES

								
;***************DE BCD A DECIMAL USANDO CARACTERES ASCII*****************		
					MOVLW			0X30				;EN CODIGO ASCII LOS NUMERO EMPIEZAN DESDE LA POSICION 0X30
					ADDWF			UNIDADES,F
					ADDWF			DECENAS,F
					ADDWF			CENTENAS,F
					RETURN

IMPRIME_DECIMAL:	MOVF			CENTENAS,W
					CALL			ESCRIBE_CARACTER	;ESCRIBE CARACTER DE CENTENAS EN LA POSICION 14
					MOVF			DECENAS,W						
					CALL			ESCRIBE_CARACTER	;ESCRIBE CARACTER DE DECENAS EN LA POSICION 15
					MOVF			UNIDADES,W
					CALL			ESCRIBE_CARACTER	;ESCRIBE CARACTER DE UNIDADES EN LA POSICION 16
					RETURN


SUBT25MS:			RETARDO_3V		.3,.47,.25
					RETURN

RETARDO_8mS:		RETARDO_2V		.6,.181			;RETARDO DE 8mS PARA LA PERSISTENCIA DE LA VISION
					RETURN
;---------------------------TABLAS------------------------------------
;---------------------------LIBRERIAS--------------------------------
					INCLUDE		<D:\Archivos\Programacion\Microcontroladores\PIC\ASSEMBLER\MPASM\PIC16F887\LIBRERIAS\LIBRERIA_RETARDOS.asm>
					INCLUDE		<D:\Archivos\Programacion\Microcontroladores\PIC\ASSEMBLER\MPASM\PIC16F887\LIBRERIAS\LIBRERIA_LCD.asm>		
					
;*************************************************************************
;COMENTARIOS
;PARA USAR ANTIREBOTE COPIAR EN SUBRUTINA 	SUBT25MS:			RETARDO_3V		.3,.47,.25
;*************************************************************************
;PARA INICIALIZAR PANTALLA LCD: LLAMAR SUBRUTINA   INIT_LCD
;PARA ESCOJER UNA COLUMNA DE LA FILA1:  	FILA1_POSICION	.X		X: 0-15
;MOSTRAR MENSAJE 1 LLAMAMOS A LA SUBRUTINA 	CALL			MENSAJE_FILA1
;PARA ESCOJER UNA COLUMNA DE LA FILA2:  	FILA2_POSICION	.X		X: 0-15
;MOSTRAR MENSAJE 2 LLAMAMOS A LA SUBRUTINA 	CALL			MENSAJE_FILA2


					END