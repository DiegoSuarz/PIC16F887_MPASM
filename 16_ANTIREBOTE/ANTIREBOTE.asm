;DESCRIPCION:
;IMPLEMENTAR UNA RUTINA DE ANTIREBOTE
;SACAR  0XF0 POR EL PUERTO D DURANTE 200 MS.
;SACAR  0X0F POR EL PUERTO D DURANTE 200 MS.

			INCLUDE		<D:\Archivos\Programacion\Microcontroladores\PIC\ASSEMBLER\MPASM\PIC16F887\00_PLANTILLA\PLANTILLA.ASM>
			;NOS DEJA EN EL BANCO 1	
			
;ETIQUETAS | NEMONICOS | OPERANDOS 		| COMENTARIOS	
			MOVLW		0X01
			MOVWF		TRISE			;RE0 COMO ENTRADA
			CLRF		TRISD
			BCF			STATUS,RP0		;BANCO 0
			
			BTFSS		PORTE,0			;RE0 == 1?
			GOTO 		$-1				;REGRESAR UNA LINEA
			CALL		T25MS			;ELIMINAR LOS REBOTES
			BTFSC		PORTE,0			;RE0 == 0?
			GOTO 		$-1				;REGRESA A LA INST ANTERIOR
			CALL		T25MS
			
			MOVLW		0XF0
			MOVWF		PORTD
			CALL		T200MS
			SWAPF		PORTD,1 
			GOTO		$-2

;-----------SUBRUTINAS DE RETARDO---------------------------
T25MS:		MOVLW		.3			;VAR1
			MOVWF		0X64
			MOVLW		.47			;VAR2
			MOVWF		0X65		
			MOVLW		.25			;VAR3
			MOVWF		0X66
			CALL		ST3V
			RETURN
			
T200MS:		MOVLW		.243			;VAR2
			MOVWF		0X61
			MOVLW		.117			;VAR1
			MOVWF		0X62
			CALL		ST2V
			RETURN

			INCLUDE		<D:\Archivos\Programacion\Microcontroladores\PIC\ASSEMBLER\MPASM\PIC16F887\LIBRERIAS\RETARDOS.ASM>
			END
			

