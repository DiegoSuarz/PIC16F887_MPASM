;DESCRIPCION:
;DEBE TENER CONECTADO UN TECLADO MATRIVILA DE 4X4 EN EL PUERTO B, CUANDO
;SE APRIETE CUALQUIER TECHA DEBERA INTERRUMPIR Y DESPLIGAR EN LA LCD (PUERTO C)
;EL NUMERO DE LA TECLA QUE SE ESTA APRETANDO (EN HEXADECIMAL)
;EN EL PROGRAMA PRINCIPAL ESTARA DE FORMA PERMANENTE EL CONTADOR DE
;00 A 99 POR LOD DISPLAYS DE 7 SEGMENTOS.
;LA LCD LLEVARA UN CONTEO CON ESPACIOS DE TIEMPO DE 0.5s CREADO POR TIMER 0
;TAMBIEN, CADA 0.5 S ADENTRO DE LA INTERRUPCION DEL TIMER0 SE HARA UNA CONVERSION
;SE IMPRIMIRA EL RESULTADO DE UNA CONVERSION ANALOGICO DIGITAL
;CAD Vres=2.5558 V. EL PINA ANALOGICO A UTILIZAR COMO ENTRADA SERA RE2/AN7.RELOJ ADC, RC INTERNO.
;DEBERA DESPLEGAR LA TEMPERATURA UTILIZANDO EL SENSOR LM35 CON UNA RESLUCION DE 0.25 °C,
;LA ENTRADA DEL SENSOR SERA RE2/AN7
;LAS CADENAS DE LA LCD SERAN:
;"XXX Vi:XXXX.X mV"
;"TECLA:X T=XXX.XX°C"
;---------------------------MACROS----------------------------
;---------------------------DEFINE----------------------------
;----------------------------EQU------------------------------
CONT5		EQU 0X23
ALEATORIO	EQU	0X24
CONT_T0		EQU	0X28
DECIMAL		EQU 0X29
NUMERO		EQU 0X30

ESTADO_PB	EQU	0X2C
ES_NUEVO_PB EQU	0X2D

TECLADO4X4	EQU 0X2E
CONT_TECL	EQU	0X2F
ADL			EQU	0X31

;---------------------------CBLOCK----------------------------
CBLOCK		0X25
					UNIDADES,DECENAS,CENTENAS
			ENDC
;---------------------------HEADER----------------------------
					INCLUDE		<D:\Archivos\Programacion\Microcontroladores\PIC\ASSEMBLER\MPASM\PIC16F887\LIBRERIAS\MACROS_INTERRUPT.ASM>	;MACRO PARA EL USO DE INTERRUPCIONES
					INCLUDE		<D:\Archivos\Programacion\Microcontroladores\PIC\ASSEMBLER\MPASM\PIC16F887\LIBRERIAS\MACROS_LCD.ASM>	;MACRO PARA EL USO DISPLAY LCD
					INCLUDE		<D:\Archivos\Programacion\Microcontroladores\PIC\ASSEMBLER\MPASM\PIC16F887\LIBRERIAS\MACROS_7SEG.ASM>	;MACRO PARA EL USO DISPLAY 7 SEG					
					INCLUDE		<D:\Archivos\Programacion\Microcontroladores\PIC\ASSEMBLER\MPASM\PIC16F887\LIBRERIAS\RETARDOS_MACROS.ASM> ;MACRO DE RETARDO
					INCLUDE		<D:\Archivos\Programacion\Microcontroladores\PIC\ASSEMBLER\MPASM\PIC16F887\LIBRERIAS\MACROS_CONFIGURACION_INT.ASM> ;MACRO DE CONFIGURACION BASICA
					ORG			0X0000			;EMPEZAR EN LA DIRECCION 0 DE LA MEMORIA DE PROGRAMA
					GOTO		INICIALIZA
					VECTOR_INTERRUPCION			;SI SE USA INTERRUPCIONES DESCOMENTAR
					SIETE_SG_KC					;SI SE USA DISPLAY 7 SEG DESCOMENTAR
					

TABLA_LCD			ADDWF			PCL,F
LCD_FILA1			ADDWF			PCL,F
;************************************                *************************************************************************
					DT				"    Vi:       mV"
LCD_FILA2			ADDWF			PCL,F
;************************************                *************************************************************************
					DT				"TEC:  T:    . "
					RETLW			0XDF		;SIMBOLO DE GRADOS CENTIGRADOS °
					RETLW			'C'													
					CONFIGURACION				;NOS DEJA EN EL BANCO 1
;-----------------------CODIGO PRINCIPAL------------------------------
;ETIQUETAS			|NEMONICOS		| OPERANDOS 		| COMENTARIOS	
									
					MOVLW			0XF0
					MOVWF			TRISB
					CLRF			TRISC
					CLRF			TRISD
					BCF				TRISA,0
					BCF				TRISA,1
					MOVLW			0XFF
					MOVWF			WPUB				;HABILITANDO RESITENCIAS DE PULL UP PUERTO B

;***********************CONFIGURACION ADC*************************************************
					BSF				STATUS,RP0
					BSF				STATUS,RP1			;ACCEDIENDO AL BANCO 3
					
					MOVLW			B'10101000'			;ENTRADA AN POR AN7 , AN5 Y VREF+ POR AN3
					MOVWF			ANSEL				;CONFIGURAR ENTRADAS ANALOGICAS
					
					BCF				STATUS,RP1
					BSF				STATUS,RP0			;ACCEDIENDO AL BANCO 1

					MOVLW			B'00010000'			;JUSTIFICADO A LA IZQUIERDA, VREF- VSS(GND), VREF+ PIN (AN3)
					MOVWF			ADCON1					

					BCF				STATUS,RP0			;BANCO 0
					MOVLW			B'11010101'			;ADC CLOCK INTERNO RC, CANAL AN5 (FUENTE DE TENSION), CONVERSION DESACTIVADA, HABILITAR ADC					
					MOVWF			ADCON0	

;************FUNCIONES DE LA LCD***************************				
					CALL			INIT_LCD			;INICIAR LA LCD
					FILA1_POSICION	.0					;POSICION DE LA FILA 1
					CALL			MENSAJE_FILA1		;MENSAJE FILA 1
					FILA2_POSICION	.0					;POSICION DE LA FILA 2
					CALL			MENSAJE_FILA2		;MENSAJE FILA 2

					
;************CONFIGURACION INTERRUPCION IOC***************************************
					
					BSF				STATUS,RP0			;BANCO 1
					MOVLW			B'01010101'			;RESISTENCIAS PULL UP PUERTO B, RB0 INT, FLACOS DE SUBIDA,TEMPORIZADOR, PRES=64
					MOVWF			OPTION_REG
					COMF			IOCB,F
					BCF				STATUS,RP0			;BANCO 0
					
					
					CLRF			CONT_T0
					MOVLW			.131				;TIMER CUENTA A 125 X 64 PREE = 8000
					MOVWF			TMR0
					
					MOVLW			.62
					MOVWF			CONT5

					MOVF			PORTB,W				;LEER EL VALOR DEL PUERTO B, CONDICION DE LAS INTERRUPCIONES IOC
					BCF				INTCON,T0IF			;LIMPIAR BANDERA DE INTERRUPCION
					BSF				INTCON,T0IE			;HABILITAR INTERRUPCION EXTERNA
					BCF				INTCON,RBIF			;LIMPIAR BANDERA DE	IOC
					BSF				INTCON,RBIE			;HABILITAR INTERRUPCION IOC
					BSF				INTCON,GIE			;HABILITAR INTERRUPCIONES GLOBALES

;*************************************************************************************************************
LIMPIA_DEC:			CLRF			DECENA				;LIMPIAMOS LA VARIABLE DECENA (0X21)			
LIMPIA_UNI:			CLRF			UNIDAD				;LIMPIAMOS LA VARIABLE UNIDAD (0X20)

			
RECARGA60:			MOVLW			.60
					MOVWF			CONT60				;CARGARMOS LA VARIABLE CONT60 CON .60

VISUALIZAR:			MOVF			UNIDAD,W			;LEEMOS LA VARIABLE UNIDAD Y LO ALMACENAMOS EN W
					CALL			SIETE_SEG			;LLAMAMOS A LA RUTINA 7 SEG
					MOVWF			PORTD				;VISUALIZAMOS LA UNIDAD POR EL PUERTO D

					UNIDAD_ENA							;ENCENDER UNIDADES DISPLAY(ENCENDER TRANSITOR RA0)
					CALL			RETARDO_8mS
					UNIDAD_DIS							;ENCENDER UNIDADES DISPLAY(APAGAR TRANSITOR RA0)

					MOVF			DECENA,W			;LEEMOS LA VARIABLE UNIDAD Y LO ALMACENAMOS EN W
					CALL			SIETE_SEG			;LLAMAMOS A LA RUTINA 7 SEG
					MOVWF			PORTD				;VISUALIZAMOS LA DECENA POR EL PUERTO D

					DECENA_ENA							;ENCENDER DECENAS DISPLAY(ENCENDER TRANSITOR RA1)
					CALL			RETARDO_8mS
					DECENA_DIS							;APAGAR DECENAS DISPLAY(APAGAR TRANSITOR RA1)
			
					DECFSZ			CONT60,F			;BUCLE PARA REPETIR 60 VECES LA VISUALIZACION DE LOS DIGITOS
					GOTO			VISUALIZAR			
		
					INCF			UNIDAD,F			;INCREMENTAR LA VARIABLE UNIDAD
					MOVLW			0X09			
					XORWF			UNIDAD,W		
					BTFSS			STATUS,Z			;UNIDAD == 9?
					GOTO			RECARGA60			;NO, VE A REPETIR HASTA QUE SE CUMPLAN LOS 60 SIGLOS
					INCF			DECENA,F			;SI, INCREMENTA DECENA EN UNA UNIDAD, Y LIMPIA UNIDADES
					MOVLW			0X09
					XORWF			DECENA,W
					BTFSS			STATUS,Z			;DECENA == 9?
					GOTO			LIMPIA_UNI			;NO, VE A LIMPIAR UNIDADES, PERO MANTENER LAS DECENAS 
					GOTO			LIMPIA_DEC			;SI, VE Y LIMPIA UNIDADES Y DECENAS
					
;*************************************************************************
					
;------------------SERVICIO DE RUTINA DE INTERRUPCION-----------------
ISR:				
					BTFSS			INTCON,T0IF
					GOTO			INT_ON_CHANGE

;**************************INTERRUPCION TMR0*******************************
					DECFSZ			CONT5,F
					GOTO            CLR_FLAG
					
					BSF				ADCON0,1		;INICIA LA CONVERSION ADC
										

					MOVLW			.62
					MOVWF			CONT5
					
					INCF			CONT_T0,F
					MOVF			CONT_T0,W
					MOVWF			NUMERO
					CALL			BIN_A_DECIMAL
				

;**************************IMPRIMIMOS CARACTERES EN EL LCD***************************************************						
					FILA1_POSICION	.0					;UBICAMOS EL CURSOR EN LA FILA 2 COLUMNA 14
					CALL			IMPRIME_DECIMAL 

					BTFSC			ADCON0,1			;YA TERMINO LA CONVESION ADC?
					GOTO 			$-1
					
					MOVLW			B'11011101'			;CAMBIO DE CANAL ANALOGICO AN7, ADC CLOCK INTERNO RC, CANAL AN5 (FUENTE DE TENSION), CONVERSION DESACTIVADA, HABILITAR ADC					
					MOVWF			ADCON0	

					MOVF			ADRESH,W
					MOVWF			NUMERO
					CALL 			BIN_A_DECIMAL
					FILA1_POSICION	.7					;UBICAMOS EL CURSOR EN LA FILA 2 COLUMNA 14				
					CALL			IMPRIME_DECIMAL		;IMPRIME EL RESULTADO DEL ADC
					BSF 			STATUS,RP0			;BANCO 1
					MOVF			ADRESL,W			;PARTE BAJA DEL REGISTRO ADC
					BCF				STATUS,RP0			;BANCO 0
					MOVWF			ADL					;MOVER LA PARTE BAJA DEL REGISTRO ADC A LA RAM , REGITRA ADL
					CLRW								;LIMPIAR EL ACUMULADOR W
					XORWF			ADL,W				
					BTFSS			STATUS,Z			;CASO 00
					GOTO 			FUE01
					MOVLW			'0'
					CALL			IMPRIME_CARACTER	
					MOVLW			'.'
					CALL			IMPRIME_CARACTER	
					MOVLW			'0'
					CALL			IMPRIME_CARACTER
					GOTO  			IMPRIME_TEMP

FUE01:				MOVLW			B'01000000'			;CASO 01
					XORWF			ADL,W
					BTFSS			STATUS,Z
					GOTO 			FUE10
					MOVLW			'2'
					CALL			IMPRIME_CARACTER	
					MOVLW			'.'
					CALL			IMPRIME_CARACTER	
					MOVLW			'5'
					CALL			IMPRIME_CARACTER		
					GOTO  			IMPRIME_TEMP
	
FUE10:				MOVLW			B'10000000'			;CASO 10
					XORWF			ADL,W
					BTFSS			STATUS,Z
					GOTO 			FUE011
					MOVLW			'5'
					CALL			IMPRIME_CARACTER	
					MOVLW			'.'
					CALL			IMPRIME_CARACTER	
					MOVLW			'0'
					CALL			IMPRIME_CARACTER		
					GOTO  			IMPRIME_TEMP	

FUE011:				MOVLW			'7'					;CASO 11
					CALL			IMPRIME_CARACTER	
					MOVLW			'.'
					CALL			IMPRIME_CARACTER	
					MOVLW			'5'
					CALL			IMPRIME_CARACTER	

IMPRIME_TEMP:		BSF				ADCON0,1			;INICIA CONVERSION
					BTFSC			ADCON0,1			;YA TERMINO LA CONVERSION ADC?
					GOTO			$-1
			
					MOVLW			B'11010101'			;CAMBIO DE CANAL ANALOGICO AN5, ADC CLOCK INTERNO RC, CANAL AN5 (FUENTE DE TENSION), CONVERSION DESACTIVADA, HABILITAR ADC					
					MOVWF			ADCON0	

					MOVF			ADRESH,W
					MOVWF			NUMERO
					CALL 			BIN_A_DECIMAL
					FILA2_POSICION	.8					;UBICAMOS EL CURSOR EN LA FILA 2 COLUMNA 14				
					CALL			IMPRIME_DECIMAL		;IMPRIME EL RESULTADO DEL ADC
					BSF 			STATUS,RP0			;BANCO 1
					MOVF			ADRESL,W			;PARTE BAJA DEL REGISTRO ADC
					BCF				STATUS,RP0			;BANCO 0
					MOVWF			ADL					;MOVER LA PARTE BAJA DEL REGISTRO ADC A LA RAM , REGITRA ADL
					CLRW								;LIMPIAR EL ACUMULADOR W
					XORWF			ADL,W				
					BTFSS			STATUS,Z			;CASO 00
					GOTO 			LM35_FUE01
					MOVLW			'.'
					CALL			IMPRIME_CARACTER	
					MOVLW			'0'
					CALL			IMPRIME_CARACTER	
					MOVLW			'0'
					CALL			IMPRIME_CARACTER
					GOTO  			CLR_FLAG

LM35_FUE01			MOVLW			B'01000000'			;CASO 01
					XORWF			ADL,W
					BTFSS			STATUS,Z
					GOTO 			LM35_FUE10
					MOVLW			'.'
					CALL			IMPRIME_CARACTER	
					MOVLW			'2'
					CALL			IMPRIME_CARACTER	
					MOVLW			'5'
					CALL			IMPRIME_CARACTER		
					GOTO  			CLR_FLAG
	
LM35_FUE10:			MOVLW			B'10000000'			;CASO 10
					XORWF			ADL,W
					BTFSS			STATUS,Z
					GOTO 			LM35_FUE011
					MOVLW			'.'
					CALL			IMPRIME_CARACTER	
					MOVLW			'5'
					CALL			IMPRIME_CARACTER	
					MOVLW			'0'
					CALL			IMPRIME_CARACTER		
					GOTO  			CLR_FLAG	

LM35_FUE011:		MOVLW			'.'					;CASO 11
					CALL			IMPRIME_CARACTER	
					MOVLW			'7'
					CALL			IMPRIME_CARACTER	
					MOVLW			'5'
					CALL			IMPRIME_CARACTER	

CLR_FLAG:			MOVLW			.131
					MOVWF			TMR0
					BCF				INTCON,T0IF			;LIMPIAMOS LA BANDERA DE INTERRUPCION INT_EXT	
					GOTO			FIN_INT

					
;**************************INTERRUPCION ON CHANGE*******************************				
INT_ON_CHANGE:		CLRF			PORTA
					CALL			SUBT25MS			;RUTINA ANTIREBOTE
					MOVLW			0XF0
					ANDWF			PORTB,W			
					MOVWF			TECLADO4X4
				
					BCF				STATUS,RP0			;B1
					MOVLW			0X0F
					MOVWF			TRISB
					BCF				OPTION_REG,7		;DESACTIVAR PULL UP PUERTO B
					BCF				STATUS,RP0			;B0
					CLRF			PORTB

					MOVLW			0X0F
					ANDWF			PORTB,W
					ADDWF			TECLADO4X4,F		;VALORES CONCATENADOS PARA BUSCAR EN LA TABLA
					
					CLRF			CONT_TECL

BUSCA_TECLA:		MOVF			CONT_TECL,W
					CALL			TABLA_TECL
					XORWF			TECLADO4X4,W
					BTFSC			STATUS,Z
					GOTO			IMPRIME_TECLA

					INCF			CONT_TECL,F
					MOVLW			.16
					XORWF			CONT_TECL,W
					BTFSS			STATUS,Z
					GOTO			BUSCA_TECLA
					MOVLW			.16
					MOVWF			CONT_TECL
					
						
IMPRIME_TECLA:		FILA2_POSICION	.4					;UBICAMOS EL CURSOR EN LA FILA 2 COLUMNA 14
					
						
								
					MOVF			CONT_TECL,W
					CALL			TABLA_HEX_ASCII
										
					CALL			IMPRIME_CARACTER
				

					MOVLW			0XF
					XORWF			PORTB,W
					BTFSS			STATUS,Z
					GOTO			$-3

				;	MOVF			PORTB,W
				;	BCF				INTCON,RBIF			;LIMPIAR BANDERA DE	IOC
				;	BTFSS			INTCON,RBIF
				;	GOTO			$-1
					
					CALL			SUBT25MS
					BSF				STATUS,RP0			;B1
					MOVLW			0XF0
					MOVWF			TRISB
					BCF				OPTION_REG,7
					BCF				STATUS,RP0
					
					MOVF			PORTB,W
					BCF				INTCON,RBIF			;LIMPIAR BANDERA DE	IOC

FIN_INT:			RESTORE_REG							;RESTAURAMOS LOS REGISTROS DE INTERES
					RETFIE								;REGRESAMOS DE LA INTERRUPCION
					
;-------------------------SUBRUTINAS----------------------------------

BIN_A_DECIMAL:		CLRF			UNIDADES
					CLRF			DECENAS
					CLRF			CENTENAS

;************************EXTRAER CENTENAS*********************************
RESTA100:			MOVLW			.100
					SUBWF			NUMERO,F
					BTFSS			STATUS,C
					GOTO			SUMA100
					INCF			CENTENAS,F
					GOTO			RESTA100
SUMA100:			MOVLW			.100
					ADDWF			NUMERO,F

;******************EXTRAER DECENAS*********************************
RESTA10:			MOVLW			.10
					SUBWF			NUMERO,F
					BTFSS			STATUS,C
					GOTO			SUMA10
					INCF			DECENAS,F
					GOTO			RESTA10
SUMA10:				MOVLW			.10
					ADDWF			NUMERO,F

;******************EXTRAER UNIDADES********************************************************
					MOVF			NUMERO,W
					MOVWF			UNIDADES

								
;***************DE BCD A DECIMAL USANDO CARACTERES ASCII*****************		
					MOVLW			0X30				;EN CODIGO ASCII LOS NUMERO EMPIEZAN DESDE LA POSICION 0X30
					ADDWF			UNIDADES,F
					ADDWF			DECENAS,F
					ADDWF			CENTENAS,F
					RETURN

IMPRIME_DECIMAL:	MOVF			CENTENAS,W
					CALL			IMPRIME_CARACTER	;ESCRIBE CARACTER DE CENTENAS EN LA POSICION 14
					MOVF			DECENAS,W						
					CALL			IMPRIME_CARACTER	;ESCRIBE CARACTER DE DECENAS EN LA POSICION 15
					MOVF			UNIDADES,W
					CALL			IMPRIME_CARACTER	;ESCRIBE CARACTER DE UNIDADES EN LA POSICION 16
					RETURN


SUBT25MS:			RETARDO_3V		.3,.47,.25
					RETURN

RETARDO_8mS:		RETARDO_2V		.6,.181			;RETARDO DE 8mS PARA LA PERSISTENCIA DE LA VISION
					RETURN
;---------------------------TABLAS------------------------------------
TABLA_TECL			ADDWF			PCL,F
					DT				0XEE,0XDE,0XBE,0X7E,0XED,0XDD, 0XBD, 0X7D,0XEB,0XDB,0XBB,0X7B,0XE7,0XD7,0XB7,0X77

TABLA_HEX_ASCII		ADDWF			PCL,F
					DT				"0123456789ABCDEF@"
;---------------------------LIBRERIAS--------------------------------
					INCLUDE		<D:\Archivos\Programacion\Microcontroladores\PIC\ASSEMBLER\MPASM\PIC16F887\LIBRERIAS\LIBRERIA_RETARDOS.asm>
					INCLUDE		<D:\Archivos\Programacion\Microcontroladores\PIC\ASSEMBLER\MPASM\PIC16F887\LIBRERIAS\LIBRERIA_LCD.asm>		
					END
;*************************************************************************
;COMENTARIOS
;PARA USAR ANTIREBOTE COPIAR EN SUBRUTINA 	SUBT25MS:			RETARDO_3V		.3,.47,.25
;*************************************************************************
;PARA INICIALIZAR PANTALLA LCD: LLAMAR SUBRUTINA   INIT_LCD
;PARA ESCOJER UNA COLUMNA DE LA FILA1:  	FILA1_POSICION	.X		X: 0-15
;MOSTRAR MENSAJE 1 LLAMAMOS A LA SUBRUTINA 	CALL			MENSAJE_FILA1
;PARA ESCOJER UNA COLUMNA DE LA FILA2:  	FILA2_POSICION	.X		X: 0-15
;MOSTRAR MENSAJE 2 LLAMAMOS A LA SUBRUTINA 	CALL			MENSAJE_FILA2