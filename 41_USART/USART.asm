;DESCRIPCION:
;SE DEBE CREAR UNA APLICACION QUE PERMITA ENVIAR POR EL PUERTO USART
;LOS DATOS QUE ESTAN EN EL PORTB, Y RECIBIR INFORMACION POR EL PUERTO 
;USART EN REFLEJARLOS EN EL PUERTD

;EN EL PROGRAMA PRINCIPAL ESTARA DE FORMA PERMANENTE EN LOS DISPLAY 7 SEG
;CONFIGURAR PUERTO USART A 2500 BAUDIOS BIT X SEG.


;---------------------------MACROS----------------------------
;---------------------------DEFINE----------------------------
;----------------------------EQU------------------------------
;---------------------------CBLOCK----------------------------
;---------------------------HEADER----------------------------
					INCLUDE		<D:\Archivos\Programacion\Microcontroladores\PIC\ASSEMBLER\MPASM\PIC16F887\LIBRERIAS\MACROS_INTERRUPT.ASM>	;MACRO PARA EL USO DE INTERRUPCIONES
;					INCLUDE		<D:\Archivos\Programacion\Microcontroladores\PIC\ASSEMBLER\MPASM\PIC16F887\LIBRERIAS\MACROS_LCD.ASM>	;MACRO PARA EL USO DISPLAY LCD
					INCLUDE		<D:\Archivos\Programacion\Microcontroladores\PIC\ASSEMBLER\MPASM\PIC16F887\LIBRERIAS\MACROS_7SEG.ASM>	;MACRO PARA EL USO DISPLAY 7 SEG					
					INCLUDE		<D:\Archivos\Programacion\Microcontroladores\PIC\ASSEMBLER\MPASM\PIC16F887\LIBRERIAS\RETARDOS_MACROS.ASM> ;MACRO DE RETARDO
					INCLUDE		<D:\Archivos\Programacion\Microcontroladores\PIC\ASSEMBLER\MPASM\PIC16F887\LIBRERIAS\MACROS_CONFIGURACION_INT.ASM> ;MACRO DE CONFIGURACION BASICA
					ORG			0X0000			;EMPEZAR EN LA DIRECCION 0 DE LA MEMORIA DE PROGRAMA
					GOTO		INICIALIZA
					VECTOR_INTERRUPCION			;SI SE USA INTERRUPCIONES DESCOMENTAR
					SIETE_SG_KC					;SI SE USA DISPLAY 7 SEG DESCOMENTAR
					CONFIGURACION				;NOS DEJA EN EL BANCO 1
;-----------------------CODIGO PRINCIPAL------------------------------
;ETIQUETAS			|NEMONICOS		| OPERANDOS 		| COMENTARIOS	
					
					CLRF			TRISC
					BCF				TRISC,6				
					BSF				TRISC,7
					CLRF			TRISD				;CONTROL DISPLAY 7 SEGMENTOS
					CLRF			TRISA				;CONTROL DE BARRA LEDS
					BCF				TRISE,0				;CONTROL DE TRANSISTORES PARA DISPLAY 7 SEG
					BCF				TRISE,1
							
;************CONFIGURACION INTERRUPCION IOC***************************************
					MOVLW			0XFF
					MOVWF			TRISB				;CONTROL DIPSW				
					MOVLW			0XFF
					MOVWF			WPUB				;HABILITANDO RESITENCIAS DE PULL UP PUERTO B
					
					BCF				OPTION_REG,7			;RESISTENCIAS PULL UP PUERTO B
					
					MOVLW			0XFF
					MOVWF			IOCB
				
					BCF				STATUS,RP0			;BANCO 0
					
					MOVF			PORTB,W				;LEER EL VALOR DEL PUERTO B, CONDICION DE LAS INTERRUPCIONES IOC
					
					BCF				INTCON,RBIF			;LIMPIAR BANDERA DE	IOC
					BSF				INTCON,RBIE			;HABILITAR INTERRUPCION IOC
					

;*********************CONFIGURACION USART****************************************************
					
					BSF				STATUS,RP0			;BANCO 1
					MOVLW			.25
					MOVLW			SPBRG				;TASA DE TRANSFERENCIA ES DE 2400 BAUDIOS, BRGH=0 Y BRG16=0, SPBRGH NO SE REQUIERE
					
					;BCF				BAUDCTL,BRG16		;(BANCO 3) POR DEFECTO 0				
					CLRF			TXSTA					
					BCF				TXSTA,BRGH			;MODO LOW SPEED
					
					BCF				TXSTA,TX9			;MODO DE OPERACION 8 BITS
					BSF				TXSTA,TXEN			;HABILITA LA TRANSMISION	
					BSF				TXSTA,TRMT			;BANDERA DE LLENADO DE BUFFER USART
					BCF				TXSTA,SYNC			;MODO EUSART ASINCRONO
					
					BCF				STATUS,RP0			;BANCO 0
					CLRF			RCSTA
			
					BSF				RCSTA,SPEN			;HABILITAR EL PUERTO USART
					BCF				RCSTA,RX9			;MODO RECEPCION 8 BITS
					BSF				RCSTA,CREN			;HABILITAR RECEPCION
					BCF				RCSTA,FERR			;BIT DE ERROR LECTURA
					BCF				RCSTA,OERR			;BIT DE ERROR DE DESBORDAMIENTO

					BCF				PIR1,RCIF			;BAJANDO BANDERA DE RECEPCION USART
					BSF				STATUS,RP0			;BANCO 1
					BSF				PIE1,RCIE			;ACTIVANDO INTERRUCPICON POR RECEPCION	
					BSF				INTCON,PEIE			;HABILITANDO INTERRUPCIONES DE PERIFERICOS
					BSF				INTCON,GIE			;HABILITAR INTERRUPCIONES GLOBALES
		
					BCF				STATUS,RP0			;BANCO 0
;**********************************************************************************************************************************************
LIMPIA_DEC:			CLRF			DECENA				;LIMPIAMOS LA VARIABLE DECENA (0X21)			
LIMPIA_UNI:			CLRF			UNIDAD				;LIMPIAMOS LA VARIABLE UNIDAD (0X20)

			
RECARGA60:			MOVLW			.60
					MOVWF			CONT60				;CARGARMOS LA VARIABLE CONT60 CON .60

VISUALIZAR:			MOVF			UNIDAD,W			;LEEMOS LA VARIABLE UNIDAD Y LO ALMACENAMOS EN W
					CALL			SIETE_SEG			;LLAMAMOS A LA RUTINA 7 SEG
					MOVWF			PORTD				;VISUALIZAMOS LA UNIDAD POR EL PUERTO D

					UNIDAD_ENA							;ENCENDER UNIDADES DISPLAY(ENCENDER TRANSITOR RA0)
					CALL			RETARDO_8mS
					UNIDAD_DIS							;ENCENDER UNIDADES DISPLAY(APAGAR TRANSITOR RA0)

					MOVF			DECENA,W			;LEEMOS LA VARIABLE UNIDAD Y LO ALMACENAMOS EN W
					CALL			SIETE_SEG			;LLAMAMOS A LA RUTINA 7 SEG
					MOVWF			PORTD				;VISUALIZAMOS LA DECENA POR EL PUERTO D

					DECENA_ENA							;ENCENDER DECENAS DISPLAY(ENCENDER TRANSITOR RA1)
					CALL			RETARDO_8mS
					DECENA_DIS							;APAGAR DECENAS DISPLAY(APAGAR TRANSITOR RA1)
			
					DECFSZ			CONT60,F			;BUCLE PARA REPETIR 60 VECES LA VISUALIZACION DE LOS DIGITOS
					GOTO			VISUALIZAR			
		
					INCF			UNIDAD,F			;INCREMENTAR LA VARIABLE UNIDAD
					MOVLW			0X09			
					XORWF			UNIDAD,W		
					BTFSS			STATUS,Z			;UNIDAD == 9?
					GOTO			RECARGA60			;NO, VE A REPETIR HASTA QUE SE CUMPLAN LOS 60 SIGLOS
					INCF			DECENA,F			;SI, INCREMENTA DECENA EN UNA UNIDAD, Y LIMPIA UNIDADES
					MOVLW			0X09
					XORWF			DECENA,W
					BTFSS			STATUS,Z			;DECENA == 9?
					GOTO			LIMPIA_UNI			;NO, VE A LIMPIAR UNIDADES, PERO MANTENER LAS DECENAS 
					GOTO			LIMPIA_DEC			;SI, VE Y LIMPIA UNIDADES Y DECENAS
					
;*************************************************************************
					
;------------------SERVICIO DE RUTINA DE INTERRUPCION-----------------
ISR:				BTFSS			PIR1,RCIF			;FUE INTERRUPCION POR RECEPCION USART?
					GOTO			INT_ON_CHANGE
					BTFSC			RCSTA,FERR
					GOTO 			RX_ERROR
					BTFSC			RCSTA,OERR	
					GOTO			RX_ERROR
					MOVF			RCREG,W
					MOVWF			PORTA
					GOTO			BAJA_FLAG

RX_ERROR:			BCF				RCSTA,CREN
					BSF				RCSTA,CREN
					MOVF			RCREG,W
 					MOVF			RCREG,W
BAJA_FLAG:			BCF				PIR1,RCIF		
					GOTO			FIN_INT					
					
;**************************INTERRUPCION ON CHANGE*******************************				
INT_ON_CHANGE:		BSF				STATUS,RP0		;BANCO 1
					BTFSS			TXSTA,TRMT		;EL BUFFER TERMINO DE LLENARSE?
					GOTO          	$-1				;AUN ESTA EN LISTO EL BUFFER		
					BCF				STATUS,RP0		;BANCO 0
					MOVF			PORTB,W
					MOVWF			TXREG
					
										
					MOVF			PORTB,W
					BCF				INTCON,RBIF			;LIMPIAR BANDERA DE	IOC
FIN_INT:			RESTORE_REG							;RESTAURAMOS LOS REGISTROS DE INTERES
					RETFIE								;REGRESAMOS DE LA INTERRUPCION
					
;-------------------------SUBRUTINAS----------------------------------
							
RETARDO_8mS:		RETARDO_2V		.6,.181			;RETARDO DE 8mS PARA LA PERSISTENCIA DE LA VISION
					RETURN
;---------------------------TABLAS------------------------------------

;---------------------------LIBRERIAS--------------------------------
					INCLUDE		<D:\Archivos\Programacion\Microcontroladores\PIC\ASSEMBLER\MPASM\PIC16F887\LIBRERIAS\LIBRERIA_RETARDOS.asm>
					END
;*************************************************************************
;COMENTARIOS
;PARA USAR ANTIREBOTE COPIAR EN SUBRUTINA 	SUBT25MS:			RETARDO_3V		.3,.47,.25
;*************************************************************************
;PARA INICIALIZAR PANTALLA LCD: LLAMAR SUBRUTINA   INIT_LCD
;PARA ESCOJER UNA COLUMNA DE LA FILA1:  	FILA1_POSICION	.X		X: 0-15
;MOSTRAR MENSAJE 1 LLAMAMOS A LA SUBRUTINA 	CALL			MENSAJE_FILA1
;PARA ESCOJER UNA COLUMNA DE LA FILA2:  	FILA2_POSICION	.X		X: 0-15
;MOSTRAR MENSAJE 2 LLAMAMOS A LA SUBRUTINA 	CALL			MENSAJE_FILA2